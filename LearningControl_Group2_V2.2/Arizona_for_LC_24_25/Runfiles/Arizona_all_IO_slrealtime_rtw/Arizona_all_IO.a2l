/******************************************************************************
* ASAP2 file: Arizona_all_IO.a2l
* Academic License - for use in teaching, academic research, and meeting
* course requirements at degree granting institutions only. Not for
* government, commercial, or other organizational use.
* Code generation for model "Arizona_all_IO".
* Model version : 1.41
* Simulink Coder version : 10.5 R2022a
* C source code generated on : Wed Apr 30 13:15:54 2025
* Target selection: slrealtime.tlc
* Embedded hardware selection: Intel->x86-64 (Linux 64)
* Code generation objectives: Unspecified
* Validation result: Not run
* (add additional file header information here)
******************************************************************************/ ASAP2_VERSION 1 71
/begin PROJECT ProjectName "Project Comment Goes Here"
/begin HEADER "Header Comments go here" /end HEADER
/begin MODULE ModuleName "Module Comment Goes Here"
/begin IF_DATA XCP
 /begin PROTOCOL_LAYER 0x0100 0x03E8 0x00C8 0x0000 0x0000 0x0000 0x0000 0x0000 0xFC 0x0578 BYTE_ORDER_MSB_LAST ADDRESS_GRANULARITY_BYTE OPTIONAL_CMD ALLOC_ODT_ENTRY OPTIONAL_CMD ALLOC_ODT OPTIONAL_CMD ALLOC_DAQ OPTIONAL_CMD FREE_DAQ OPTIONAL_CMD GET_DAQ_CLOCK OPTIONAL_CMD GET_DAQ_RESOLUTION_INFO OPTIONAL_CMD GET_DAQ_PROCESSOR_INFO OPTIONAL_CMD START_STOP_SYNCH OPTIONAL_CMD START_STOP_DAQ_LIST OPTIONAL_CMD SET_DAQ_LIST_MODE OPTIONAL_CMD WRITE_DAQ OPTIONAL_CMD SET_DAQ_PTR OPTIONAL_CMD GET_CAL_PAGE OPTIONAL_CMD SET_CAL_PAGE OPTIONAL_CMD COPY_CAL_PAGE OPTIONAL_CMD SHORT_DOWNLOAD OPTIONAL_CMD DOWNLOAD_MAX OPTIONAL_CMD DOWNLOAD OPTIONAL_CMD SHORT_UPLOAD OPTIONAL_CMD UPLOAD OPTIONAL_CMD SET_MTA OPTIONAL_CMD GET_SEGMENT_INFO OPTIONAL_CMD GET_PAGE_INFO OPTIONAL_CMD SET_SEGMENT_MODE OPTIONAL_CMD GET_SEGMENT_MODE OPTIONAL_CMD GET_PAG_PROCESSOR_INFO OPTIONAL_CMD MODIFY_BITS /end PROTOCOL_LAYER
 /begin DAQ DYNAMIC 0x0000 0x0080 0x00 OPTIMISATION_TYPE_DEFAULT ADDRESS_EXTENSION_FREE IDENTIFICATION_FIELD_TYPE_RELATIVE_WORD_ALIGNED GRANULARITY_ODT_ENTRY_SIZE_DAQ_BYTE 0xFF OVERLOAD_INDICATION_PID PRESCALER_SUPPORTED /begin STIM GRANULARITY_ODT_ENTRY_SIZE_STIM_BYTE 0xFF /end STIM /begin TIMESTAMP_SUPPORTED 0x0001 SIZE_DWORD UNIT_1US TIMESTAMP_FIXED /end TIMESTAMP_SUPPORTED /begin EVENT "1 ms" "1 ms" 0x0000 DAQ 0xFF 0x01 0x06 0x00 /end EVENT /end DAQ
 /begin XCP_ON_UDP_IP 0x0100 0x15B3 ADDRESS "192.168.7.5" /end XCP_ON_UDP_IP
/end IF_DATA
/begin MOD_PAR "MOD PAR Comment Goes Here"
 /begin MEMORY_SEGMENT Arizona_all_IO_cal_impl "Arizona_all_IO_cal_impl" DATA FLASH INTERN 0x0021D060 0x1E78 -1 -1 -1 -1 -1
  /begin IF_DATA XCP
   /begin SEGMENT 0x00 0x02 0x00 0x00 0x00
    /begin PAGE 0x00 ECU_ACCESS_DONT_CARE XCP_READ_ACCESS_DONT_CARE XCP_WRITE_ACCESS_NOT_ALLOWED /end PAGE
    /begin PAGE 0x01 ECU_ACCESS_DONT_CARE XCP_READ_ACCESS_DONT_CARE XCP_WRITE_ACCESS_DONT_CARE /end PAGE
   /end SEGMENT
  /end IF_DATA
 /end MEMORY_SEGMENT
/end MOD_PAR
/begin MOD_COMMON "Mod Common Comment Here" BYTE_ORDER MSB_LAST ALIGNMENT_BYTE 1 ALIGNMENT_WORD 2 ALIGNMENT_LONG 4 ALIGNMENT_FLOAT32_IEEE 4 ALIGNMENT_FLOAT64_IEEE 8 ALIGNMENT_INT64 8 /end MOD_COMMON
/begin CHARACTERISTIC Arizona_all_IO_cal_impl.Analoginput1_P1 "" VALUE 0x0021D518 Scalar_FLOAT64_IEEE 0 Arizona_all_IO_CM_double -1.7E+308 1.7E+308 /end CHARACTERISTIC
/begin CHARACTERISTIC Arizona_all_IO_cal_impl.Analoginput1_P10 "" VALUE 0x0021D678 Scalar_FLOAT64_IEEE 0 Arizona_all_IO_CM_double -1.7E+308 1.7E+308 /end CHARACTERISTIC
/begin CHARACTERISTIC Arizona_all_IO_cal_impl.Analoginput1_P11 "" VAL_BLK 0x0021D690 Scalar_FLOAT64_IEEE 0 Arizona_all_IO_CM_double -1.7E+308 1.7E+308 MATRIX_DIM 4 1 /end CHARACTERISTIC
/begin CHARACTERISTIC Arizona_all_IO_cal_impl.Analoginput1_P12 "" VALUE 0x0021D6C0 Scalar_FLOAT64_IEEE 0 Arizona_all_IO_CM_double -1.7E+308 1.7E+308 /end CHARACTERISTIC
/begin CHARACTERISTIC Arizona_all_IO_cal_impl.Analoginput1_P2 "" VALUE 0x0021D530 Scalar_FLOAT64_IEEE 0 Arizona_all_IO_CM_double -1.7E+308 1.7E+308 /end CHARACTERISTIC
/begin CHARACTERISTIC Arizona_all_IO_cal_impl.Analoginput1_P3 "" VALUE 0x0021D548 Scalar_FLOAT64_IEEE 0 Arizona_all_IO_CM_double -1.7E+308 1.7E+308 /end CHARACTERISTIC
/begin CHARACTERISTIC Arizona_all_IO_cal_impl.Analoginput1_P4 "" VALUE 0x0021D560 Scalar_FLOAT64_IEEE 0 Arizona_all_IO_CM_double -1.7E+308 1.7E+308 /end CHARACTERISTIC
/begin CHARACTERISTIC Arizona_all_IO_cal_impl.Analoginput1_P5 "" VALUE 0x0021D578 Scalar_FLOAT64_IEEE 0 Arizona_all_IO_CM_double -1.7E+308 1.7E+308 /end CHARACTERISTIC
/begin CHARACTERISTIC Arizona_all_IO_cal_impl.Analoginput1_P6 "" VAL_BLK 0x0021D590 Scalar_FLOAT64_IEEE 0 Arizona_all_IO_CM_double -1.7E+308 1.7E+308 MATRIX_DIM 2 1 /end CHARACTERISTIC
/begin CHARACTERISTIC Arizona_all_IO_cal_impl.Analoginput1_P7 "" VAL_BLK 0x0021D5B0 Scalar_FLOAT64_IEEE 0 Arizona_all_IO_CM_double -1.7E+308 1.7E+308 MATRIX_DIM 16 1 /end CHARACTERISTIC
/begin CHARACTERISTIC Arizona_all_IO_cal_impl.Analoginput1_P8 "" VAL_BLK 0x0021D640 Scalar_FLOAT64_IEEE 0 Arizona_all_IO_CM_double -1.7E+308 1.7E+308 MATRIX_DIM 2 1 /end CHARACTERISTIC
/begin CHARACTERISTIC Arizona_all_IO_cal_impl.Analoginput1_P9 "" VALUE 0x0021D660 Scalar_FLOAT64_IEEE 0 Arizona_all_IO_CM_double -1.7E+308 1.7E+308 /end CHARACTERISTIC
/begin CHARACTERISTIC Arizona_all_IO_cal_impl.Analogoutput2_P1 "" VALUE 0x0021D710 Scalar_FLOAT64_IEEE 0 Arizona_all_IO_CM_double -1.7E+308 1.7E+308 /end CHARACTERISTIC
/begin CHARACTERISTIC Arizona_all_IO_cal_impl.Analogoutput2_P10 "" VALUE 0x0021D848 Scalar_FLOAT64_IEEE 0 Arizona_all_IO_CM_double -1.7E+308 1.7E+308 /end CHARACTERISTIC
/begin CHARACTERISTIC Arizona_all_IO_cal_impl.Analogoutput2_P11 "" VALUE 0x0021D860 Scalar_FLOAT64_IEEE 0 Arizona_all_IO_CM_double -1.7E+308 1.7E+308 /end CHARACTERISTIC
/begin CHARACTERISTIC Arizona_all_IO_cal_impl.Analogoutput2_P12 "" VAL_BLK 0x0021D878 Scalar_FLOAT64_IEEE 0 Arizona_all_IO_CM_double -1.7E+308 1.7E+308 MATRIX_DIM 4 1 /end CHARACTERISTIC
/begin CHARACTERISTIC Arizona_all_IO_cal_impl.Analogoutput2_P13 "" VALUE 0x0021D8A8 Scalar_FLOAT64_IEEE 0 Arizona_all_IO_CM_double -1.7E+308 1.7E+308 /end CHARACTERISTIC
/begin CHARACTERISTIC Arizona_all_IO_cal_impl.Analogoutput2_P14 "" VALUE 0x0021D8C0 Scalar_FLOAT64_IEEE 0 Arizona_all_IO_CM_double -1.7E+308 1.7E+308 /end CHARACTERISTIC
/begin CHARACTERISTIC Arizona_all_IO_cal_impl.Analogoutput2_P2 "" VALUE 0x0021D728 Scalar_FLOAT64_IEEE 0 Arizona_all_IO_CM_double -1.7E+308 1.7E+308 /end CHARACTERISTIC
/begin CHARACTERISTIC Arizona_all_IO_cal_impl.Analogoutput2_P3 "" VALUE 0x0021D740 Scalar_FLOAT64_IEEE 0 Arizona_all_IO_CM_double -1.7E+308 1.7E+308 /end CHARACTERISTIC
/begin CHARACTERISTIC Arizona_all_IO_cal_impl.Analogoutput2_P4 "" VALUE 0x0021D758 Scalar_FLOAT64_IEEE 0 Arizona_all_IO_CM_double -1.7E+308 1.7E+308 /end CHARACTERISTIC
/begin CHARACTERISTIC Arizona_all_IO_cal_impl.Analogoutput2_P5 "" VAL_BLK 0x0021D770 Scalar_FLOAT64_IEEE 0 Arizona_all_IO_CM_double -1.7E+308 1.7E+308 MATRIX_DIM 3 1 /end CHARACTERISTIC
/begin CHARACTERISTIC Arizona_all_IO_cal_impl.Analogoutput2_P6 "" VAL_BLK 0x0021D798 Scalar_FLOAT64_IEEE 0 Arizona_all_IO_CM_double -1.7E+308 1.7E+308 MATRIX_DIM 4 1 /end CHARACTERISTIC
/begin CHARACTERISTIC Arizona_all_IO_cal_impl.Analogoutput2_P7 "" VAL_BLK 0x0021D7C8 Scalar_FLOAT64_IEEE 0 Arizona_all_IO_CM_double -1.7E+308 1.7E+308 MATRIX_DIM 4 1 /end CHARACTERISTIC
/begin CHARACTERISTIC Arizona_all_IO_cal_impl.Analogoutput2_P8 "" VAL_BLK 0x0021D7F8 Scalar_FLOAT64_IEEE 0 Arizona_all_IO_CM_double -1.7E+308 1.7E+308 MATRIX_DIM 3 1 /end CHARACTERISTIC
/begin CHARACTERISTIC Arizona_all_IO_cal_impl.Analogoutput2_P9 "" VAL_BLK 0x0021D820 Scalar_FLOAT64_IEEE 0 Arizona_all_IO_CM_double -1.7E+308 1.7E+308 MATRIX_DIM 3 1 /end CHARACTERISTIC
/begin CHARACTERISTIC Arizona_all_IO_cal_impl.BandLimitedWhiteNoiseforcarri_p "" VALUE 0x0021D068 Scalar_FLOAT64_IEEE 0 Arizona_all_IO_CM_double -1.7E+308 1.7E+308 /end CHARACTERISTIC
/begin CHARACTERISTIC Arizona_all_IO_cal_impl.BandLimitedWhiteNoiseforcarriag "" VALUE 0x0021D060 Scalar_FLOAT64_IEEE 0 Arizona_all_IO_CM_double -1.7E+308 1.7E+308 /end CHARACTERISTIC
/begin CHARACTERISTIC Arizona_all_IO_cal_impl.Cariagesecundair_P1 "" VALUE 0x0021D8D8 Scalar_FLOAT64_IEEE 0 Arizona_all_IO_CM_double -1.7E+308 1.7E+308 /end CHARACTERISTIC
/begin CHARACTERISTIC Arizona_all_IO_cal_impl.Cariagesecundair_P10 "" VALUE 0x0021D9B0 Scalar_FLOAT64_IEEE 0 Arizona_all_IO_CM_double -1.7E+308 1.7E+308 /end CHARACTERISTIC
/begin CHARACTERISTIC Arizona_all_IO_cal_impl.Cariagesecundair_P11 "" VALUE 0x0021D9C8 Scalar_FLOAT64_IEEE 0 Arizona_all_IO_CM_double -1.7E+308 1.7E+308 /end CHARACTERISTIC
/begin CHARACTERISTIC Arizona_all_IO_cal_impl.Cariagesecundair_P12 "" VALUE 0x0021D9E0 Scalar_FLOAT64_IEEE 0 Arizona_all_IO_CM_double -1.7E+308 1.7E+308 /end CHARACTERISTIC
/begin CHARACTERISTIC Arizona_all_IO_cal_impl.Cariagesecundair_P13 "" VALUE 0x0021D9F8 Scalar_FLOAT64_IEEE 0 Arizona_all_IO_CM_double -1.7E+308 1.7E+308 /end CHARACTERISTIC
/begin CHARACTERISTIC Arizona_all_IO_cal_impl.Cariagesecundair_P14 "" VALUE 0x0021DA10 Scalar_FLOAT64_IEEE 0 Arizona_all_IO_CM_double -1.7E+308 1.7E+308 /end CHARACTERISTIC
/begin CHARACTERISTIC Arizona_all_IO_cal_impl.Cariagesecundair_P15 "" VALUE 0x0021DA28 Scalar_FLOAT64_IEEE 0 Arizona_all_IO_CM_double -1.7E+308 1.7E+308 /end CHARACTERISTIC
/begin CHARACTERISTIC Arizona_all_IO_cal_impl.Cariagesecundair_P16 "" VALUE 0x0021DA40 Scalar_FLOAT64_IEEE 0 Arizona_all_IO_CM_double -1.7E+308 1.7E+308 /end CHARACTERISTIC
/begin CHARACTERISTIC Arizona_all_IO_cal_impl.Cariagesecundair_P17 "" VALUE 0x0021DA58 Scalar_FLOAT64_IEEE 0 Arizona_all_IO_CM_double -1.7E+308 1.7E+308 /end CHARACTERISTIC
/begin CHARACTERISTIC Arizona_all_IO_cal_impl.Cariagesecundair_P18 "" VALUE 0x0021DA70 Scalar_FLOAT64_IEEE 0 Arizona_all_IO_CM_double -1.7E+308 1.7E+308 /end CHARACTERISTIC
/begin CHARACTERISTIC Arizona_all_IO_cal_impl.Cariagesecundair_P19 "" VALUE 0x0021DA88 Scalar_FLOAT64_IEEE 0 Arizona_all_IO_CM_double -1.7E+308 1.7E+308 /end CHARACTERISTIC
/begin CHARACTERISTIC Arizona_all_IO_cal_impl.Cariagesecundair_P2 "" VALUE 0x0021D8F0 Scalar_FLOAT64_IEEE 0 Arizona_all_IO_CM_double -1.7E+308 1.7E+308 /end CHARACTERISTIC
/begin CHARACTERISTIC Arizona_all_IO_cal_impl.Cariagesecundair_P20 "" VALUE 0x0021DAA0 Scalar_FLOAT64_IEEE 0 Arizona_all_IO_CM_double -1.7E+308 1.7E+308 /end CHARACTERISTIC
/begin CHARACTERISTIC Arizona_all_IO_cal_impl.Cariagesecundair_P21 "" VALUE 0x0021DAB8 Scalar_FLOAT64_IEEE 0 Arizona_all_IO_CM_double -1.7E+308 1.7E+308 /end CHARACTERISTIC
/begin CHARACTERISTIC Arizona_all_IO_cal_impl.Cariagesecundair_P22 "" VALUE 0x0021DAD0 Scalar_FLOAT64_IEEE 0 Arizona_all_IO_CM_double -1.7E+308 1.7E+308 /end CHARACTERISTIC
/begin CHARACTERISTIC Arizona_all_IO_cal_impl.Cariagesecundair_P23 "" VALUE 0x0021DAE8 Scalar_FLOAT64_IEEE 0 Arizona_all_IO_CM_double -1.7E+308 1.7E+308 /end CHARACTERISTIC
/begin CHARACTERISTIC Arizona_all_IO_cal_impl.Cariagesecundair_P24 "" VALUE 0x0021DB00 Scalar_FLOAT64_IEEE 0 Arizona_all_IO_CM_double -1.7E+308 1.7E+308 /end CHARACTERISTIC
/begin CHARACTERISTIC Arizona_all_IO_cal_impl.Cariagesecundair_P3 "" VALUE 0x0021D908 Scalar_FLOAT64_IEEE 0 Arizona_all_IO_CM_double -1.7E+308 1.7E+308 /end CHARACTERISTIC
/begin CHARACTERISTIC Arizona_all_IO_cal_impl.Cariagesecundair_P4 "" VALUE 0x0021D920 Scalar_FLOAT64_IEEE 0 Arizona_all_IO_CM_double -1.7E+308 1.7E+308 /end CHARACTERISTIC
/begin CHARACTERISTIC Arizona_all_IO_cal_impl.Cariagesecundair_P5 "" VALUE 0x0021D938 Scalar_FLOAT64_IEEE 0 Arizona_all_IO_CM_double -1.7E+308 1.7E+308 /end CHARACTERISTIC
/begin CHARACTERISTIC Arizona_all_IO_cal_impl.Cariagesecundair_P6 "" VALUE 0x0021D950 Scalar_FLOAT64_IEEE 0 Arizona_all_IO_CM_double -1.7E+308 1.7E+308 /end CHARACTERISTIC
/begin CHARACTERISTIC Arizona_all_IO_cal_impl.Cariagesecundair_P7 "" VALUE 0x0021D968 Scalar_FLOAT64_IEEE 0 Arizona_all_IO_CM_double -1.7E+308 1.7E+308 /end CHARACTERISTIC
/begin CHARACTERISTIC Arizona_all_IO_cal_impl.Cariagesecundair_P8 "" VALUE 0x0021D980 Scalar_FLOAT64_IEEE 0 Arizona_all_IO_CM_double -1.7E+308 1.7E+308 /end CHARACTERISTIC
/begin CHARACTERISTIC Arizona_all_IO_cal_impl.Cariagesecundair_P9 "" VALUE 0x0021D998 Scalar_FLOAT64_IEEE 0 Arizona_all_IO_CM_double -1.7E+308 1.7E+308 /end CHARACTERISTIC
/begin CHARACTERISTIC Arizona_all_IO_cal_impl.Carriageenable0Inhibit1Enable_V "" VALUE 0x0021DB08 Scalar_FLOAT64_IEEE 0 Arizona_all_IO_CM_double -1.7E+308 1.7E+308 /end CHARACTERISTIC
/begin CHARACTERISTIC Arizona_all_IO_cal_impl.Carriageencoder_P1 "" VALUE 0x0021DBE0 Scalar_FLOAT64_IEEE 0 Arizona_all_IO_CM_double -1.7E+308 1.7E+308 /end CHARACTERISTIC
/begin CHARACTERISTIC Arizona_all_IO_cal_impl.Carriageencoder_P10 "" VALUE 0x0021DCB8 Scalar_FLOAT64_IEEE 0 Arizona_all_IO_CM_double -1.7E+308 1.7E+308 /end CHARACTERISTIC
/begin CHARACTERISTIC Arizona_all_IO_cal_impl.Carriageencoder_P11 "" VALUE 0x0021DCD0 Scalar_FLOAT64_IEEE 0 Arizona_all_IO_CM_double -1.7E+308 1.7E+308 /end CHARACTERISTIC
/begin CHARACTERISTIC Arizona_all_IO_cal_impl.Carriageencoder_P12 "" VALUE 0x0021DCE8 Scalar_FLOAT64_IEEE 0 Arizona_all_IO_CM_double -1.7E+308 1.7E+308 /end CHARACTERISTIC
/begin CHARACTERISTIC Arizona_all_IO_cal_impl.Carriageencoder_P13 "" VALUE 0x0021DD00 Scalar_FLOAT64_IEEE 0 Arizona_all_IO_CM_double -1.7E+308 1.7E+308 /end CHARACTERISTIC
/begin CHARACTERISTIC Arizona_all_IO_cal_impl.Carriageencoder_P14 "" VALUE 0x0021DD18 Scalar_FLOAT64_IEEE 0 Arizona_all_IO_CM_double -1.7E+308 1.7E+308 /end CHARACTERISTIC
/begin CHARACTERISTIC Arizona_all_IO_cal_impl.Carriageencoder_P15 "" VALUE 0x0021DD30 Scalar_FLOAT64_IEEE 0 Arizona_all_IO_CM_double -1.7E+308 1.7E+308 /end CHARACTERISTIC
/begin CHARACTERISTIC Arizona_all_IO_cal_impl.Carriageencoder_P16 "" VALUE 0x0021DD48 Scalar_FLOAT64_IEEE 0 Arizona_all_IO_CM_double -1.7E+308 1.7E+308 /end CHARACTERISTIC
/begin CHARACTERISTIC Arizona_all_IO_cal_impl.Carriageencoder_P17 "" VALUE 0x0021DD60 Scalar_FLOAT64_IEEE 0 Arizona_all_IO_CM_double -1.7E+308 1.7E+308 /end CHARACTERISTIC
/begin CHARACTERISTIC Arizona_all_IO_cal_impl.Carriageencoder_P18 "" VALUE 0x0021DD78 Scalar_FLOAT64_IEEE 0 Arizona_all_IO_CM_double -1.7E+308 1.7E+308 /end CHARACTERISTIC
/begin CHARACTERISTIC Arizona_all_IO_cal_impl.Carriageencoder_P19 "" VALUE 0x0021DD90 Scalar_FLOAT64_IEEE 0 Arizona_all_IO_CM_double -1.7E+308 1.7E+308 /end CHARACTERISTIC
/begin CHARACTERISTIC Arizona_all_IO_cal_impl.Carriageencoder_P2 "" VALUE 0x0021DBF8 Scalar_FLOAT64_IEEE 0 Arizona_all_IO_CM_double -1.7E+308 1.7E+308 /end CHARACTERISTIC
/begin CHARACTERISTIC Arizona_all_IO_cal_impl.Carriageencoder_P20 "" VALUE 0x0021DDA8 Scalar_FLOAT64_IEEE 0 Arizona_all_IO_CM_double -1.7E+308 1.7E+308 /end CHARACTERISTIC
/begin CHARACTERISTIC Arizona_all_IO_cal_impl.Carriageencoder_P21 "" VALUE 0x0021DDC0 Scalar_FLOAT64_IEEE 0 Arizona_all_IO_CM_double -1.7E+308 1.7E+308 /end CHARACTERISTIC
/begin CHARACTERISTIC Arizona_all_IO_cal_impl.Carriageencoder_P22 "" VALUE 0x0021DDD8 Scalar_FLOAT64_IEEE 0 Arizona_all_IO_CM_double -1.7E+308 1.7E+308 /end CHARACTERISTIC
/begin CHARACTERISTIC Arizona_all_IO_cal_impl.Carriageencoder_P23 "" VALUE 0x0021DDF0 Scalar_FLOAT64_IEEE 0 Arizona_all_IO_CM_double -1.7E+308 1.7E+308 /end CHARACTERISTIC
/begin CHARACTERISTIC Arizona_all_IO_cal_impl.Carriageencoder_P24 "" VALUE 0x0021DE08 Scalar_FLOAT64_IEEE 0 Arizona_all_IO_CM_double -1.7E+308 1.7E+308 /end CHARACTERISTIC
/begin CHARACTERISTIC Arizona_all_IO_cal_impl.Carriageencoder_P3 "" VALUE 0x0021DC10 Scalar_FLOAT64_IEEE 0 Arizona_all_IO_CM_double -1.7E+308 1.7E+308 /end CHARACTERISTIC
/begin CHARACTERISTIC Arizona_all_IO_cal_impl.Carriageencoder_P4 "" VALUE 0x0021DC28 Scalar_FLOAT64_IEEE 0 Arizona_all_IO_CM_double -1.7E+308 1.7E+308 /end CHARACTERISTIC
/begin CHARACTERISTIC Arizona_all_IO_cal_impl.Carriageencoder_P5 "" VALUE 0x0021DC40 Scalar_FLOAT64_IEEE 0 Arizona_all_IO_CM_double -1.7E+308 1.7E+308 /end CHARACTERISTIC
/begin CHARACTERISTIC Arizona_all_IO_cal_impl.Carriageencoder_P6 "" VALUE 0x0021DC58 Scalar_FLOAT64_IEEE 0 Arizona_all_IO_CM_double -1.7E+308 1.7E+308 /end CHARACTERISTIC
/begin CHARACTERISTIC Arizona_all_IO_cal_impl.Carriageencoder_P7 "" VALUE 0x0021DC70 Scalar_FLOAT64_IEEE 0 Arizona_all_IO_CM_double -1.7E+308 1.7E+308 /end CHARACTERISTIC
/begin CHARACTERISTIC Arizona_all_IO_cal_impl.Carriageencoder_P8 "" VALUE 0x0021DC88 Scalar_FLOAT64_IEEE 0 Arizona_all_IO_CM_double -1.7E+308 1.7E+308 /end CHARACTERISTIC
/begin CHARACTERISTIC Arizona_all_IO_cal_impl.Carriageencoder_P9 "" VALUE 0x0021DCA0 Scalar_FLOAT64_IEEE 0 Arizona_all_IO_CM_double -1.7E+308 1.7E+308 /end CHARACTERISTIC
/begin CHARACTERISTIC Arizona_all_IO_cal_impl.DILimitCarriage_P1 "" VALUE 0x0021DE20 Scalar_FLOAT64_IEEE 0 Arizona_all_IO_CM_double -1.7E+308 1.7E+308 /end CHARACTERISTIC
/begin CHARACTERISTIC Arizona_all_IO_cal_impl.DILimitCarriage_P2 "" VALUE 0x0021DE38 Scalar_FLOAT64_IEEE 0 Arizona_all_IO_CM_double -1.7E+308 1.7E+308 /end CHARACTERISTIC
/begin CHARACTERISTIC Arizona_all_IO_cal_impl.DILimitCarriage_P3 "" VALUE 0x0021DE50 Scalar_FLOAT64_IEEE 0 Arizona_all_IO_CM_double -1.7E+308 1.7E+308 /end CHARACTERISTIC
/begin CHARACTERISTIC Arizona_all_IO_cal_impl.DILimitCarriage_P4 "" VALUE 0x0021DE68 Scalar_FLOAT64_IEEE 0 Arizona_all_IO_CM_double -1.7E+308 1.7E+308 /end CHARACTERISTIC
/begin CHARACTERISTIC Arizona_all_IO_cal_impl.DILimitCarriage_P5 "" VALUE 0x0021DE80 Scalar_FLOAT64_IEEE 0 Arizona_all_IO_CM_double -1.7E+308 1.7E+308 /end CHARACTERISTIC
/begin CHARACTERISTIC Arizona_all_IO_cal_impl.DILimitCarriage_P6 "" VALUE 0x0021DE98 Scalar_FLOAT64_IEEE 0 Arizona_all_IO_CM_double -1.7E+308 1.7E+308 /end CHARACTERISTIC
/begin CHARACTERISTIC Arizona_all_IO_cal_impl.DILimitCarriagesecundairwerk_cm "" VALUE 0x0021DF10 Scalar_FLOAT64_IEEE 0 Arizona_all_IO_CM_double -1.7E+308 1.7E+308 /end CHARACTERISTIC
/begin CHARACTERISTIC Arizona_all_IO_cal_impl.DILimitCarriagesecundairwerkt_a "" VALUE 0x0021DEE0 Scalar_FLOAT64_IEEE 0 Arizona_all_IO_CM_double -1.7E+308 1.7E+308 /end CHARACTERISTIC
/begin CHARACTERISTIC Arizona_all_IO_cal_impl.DILimitCarriagesecundairwerkt_c "" VALUE 0x0021DEC8 Scalar_FLOAT64_IEEE 0 Arizona_all_IO_CM_double -1.7E+308 1.7E+308 /end CHARACTERISTIC
/begin CHARACTERISTIC Arizona_all_IO_cal_impl.DILimitCarriagesecundairwerkt_k "" VALUE 0x0021DEB0 Scalar_FLOAT64_IEEE 0 Arizona_all_IO_CM_double -1.7E+308 1.7E+308 /end CHARACTERISTIC
/begin CHARACTERISTIC Arizona_all_IO_cal_impl.DILimitCarriagesecundairwerkt_n "" VALUE 0x0021DF28 Scalar_FLOAT64_IEEE 0 Arizona_all_IO_CM_double -1.7E+308 1.7E+308 /end CHARACTERISTIC
/begin CHARACTERISTIC Arizona_all_IO_cal_impl.DILimitCarriagesecundairwerkt_p "" VALUE 0x0021DEF8 Scalar_FLOAT64_IEEE 0 Arizona_all_IO_CM_double -1.7E+308 1.7E+308 /end CHARACTERISTIC
/begin CHARACTERISTIC Arizona_all_IO_cal_impl.DILimitGantryx1GantryxR_P1 "" VALUE 0x0021DF40 Scalar_FLOAT64_IEEE 0 Arizona_all_IO_CM_double -1.7E+308 1.7E+308 /end CHARACTERISTIC
/begin CHARACTERISTIC Arizona_all_IO_cal_impl.DILimitGantryx1GantryxR_P2 "" VALUE 0x0021DF58 Scalar_FLOAT64_IEEE 0 Arizona_all_IO_CM_double -1.7E+308 1.7E+308 /end CHARACTERISTIC
/begin CHARACTERISTIC Arizona_all_IO_cal_impl.DILimitGantryx1GantryxR_P3 "" VALUE 0x0021DF70 Scalar_FLOAT64_IEEE 0 Arizona_all_IO_CM_double -1.7E+308 1.7E+308 /end CHARACTERISTIC
/begin CHARACTERISTIC Arizona_all_IO_cal_impl.DILimitGantryx1GantryxR_P4 "" VALUE 0x0021DF88 Scalar_FLOAT64_IEEE 0 Arizona_all_IO_CM_double -1.7E+308 1.7E+308 /end CHARACTERISTIC
/begin CHARACTERISTIC Arizona_all_IO_cal_impl.DILimitGantryx1GantryxR_P5 "" VALUE 0x0021DFA0 Scalar_FLOAT64_IEEE 0 Arizona_all_IO_CM_double -1.7E+308 1.7E+308 /end CHARACTERISTIC
/begin CHARACTERISTIC Arizona_all_IO_cal_impl.DILimitGantryx1GantryxR_P6 "" VALUE 0x0021DFB8 Scalar_FLOAT64_IEEE 0 Arizona_all_IO_CM_double -1.7E+308 1.7E+308 /end CHARACTERISTIC
/begin CHARACTERISTIC Arizona_all_IO_cal_impl.DILimitGantryx1secundairGant_bw "" VALUE 0x0021E030 Scalar_FLOAT64_IEEE 0 Arizona_all_IO_CM_double -1.7E+308 1.7E+308 /end CHARACTERISTIC
/begin CHARACTERISTIC Arizona_all_IO_cal_impl.DILimitGantryx1secundairGantr_b "" VALUE 0x0021E000 Scalar_FLOAT64_IEEE 0 Arizona_all_IO_CM_double -1.7E+308 1.7E+308 /end CHARACTERISTIC
/begin CHARACTERISTIC Arizona_all_IO_cal_impl.DILimitGantryx1secundairGantr_f "" VALUE 0x0021E018 Scalar_FLOAT64_IEEE 0 Arizona_all_IO_CM_double -1.7E+308 1.7E+308 /end CHARACTERISTIC
/begin CHARACTERISTIC Arizona_all_IO_cal_impl.DILimitGantryx1secundairGantr_h "" VALUE 0x0021DFD0 Scalar_FLOAT64_IEEE 0 Arizona_all_IO_CM_double -1.7E+308 1.7E+308 /end CHARACTERISTIC
/begin CHARACTERISTIC Arizona_all_IO_cal_impl.DILimitGantryx1secundairGantr_m "" VALUE 0x0021E048 Scalar_FLOAT64_IEEE 0 Arizona_all_IO_CM_double -1.7E+308 1.7E+308 /end CHARACTERISTIC
/begin CHARACTERISTIC Arizona_all_IO_cal_impl.DILimitGantryx1secundairGantr_o "" VALUE 0x0021DFE8 Scalar_FLOAT64_IEEE 0 Arizona_all_IO_CM_double -1.7E+308 1.7E+308 /end CHARACTERISTIC
/begin CHARACTERISTIC Arizona_all_IO_cal_impl.DILimitGantryx2GantryxL_P1 "" VALUE 0x0021E060 Scalar_FLOAT64_IEEE 0 Arizona_all_IO_CM_double -1.7E+308 1.7E+308 /end CHARACTERISTIC
/begin CHARACTERISTIC Arizona_all_IO_cal_impl.DILimitGantryx2GantryxL_P2 "" VALUE 0x0021E078 Scalar_FLOAT64_IEEE 0 Arizona_all_IO_CM_double -1.7E+308 1.7E+308 /end CHARACTERISTIC
/begin CHARACTERISTIC Arizona_all_IO_cal_impl.DILimitGantryx2GantryxL_P3 "" VALUE 0x0021E090 Scalar_FLOAT64_IEEE 0 Arizona_all_IO_CM_double -1.7E+308 1.7E+308 /end CHARACTERISTIC
/begin CHARACTERISTIC Arizona_all_IO_cal_impl.DILimitGantryx2GantryxL_P4 "" VALUE 0x0021E0A8 Scalar_FLOAT64_IEEE 0 Arizona_all_IO_CM_double -1.7E+308 1.7E+308 /end CHARACTERISTIC
/begin CHARACTERISTIC Arizona_all_IO_cal_impl.DILimitGantryx2GantryxL_P5 "" VALUE 0x0021E0C0 Scalar_FLOAT64_IEEE 0 Arizona_all_IO_CM_double -1.7E+308 1.7E+308 /end CHARACTERISTIC
/begin CHARACTERISTIC Arizona_all_IO_cal_impl.DILimitGantryx2GantryxL_P6 "" VALUE 0x0021E0D8 Scalar_FLOAT64_IEEE 0 Arizona_all_IO_CM_double -1.7E+308 1.7E+308 /end CHARACTERISTIC
/begin CHARACTERISTIC Arizona_all_IO_cal_impl.DILimitGantryx2secundairGantr_e "" VALUE 0x0021E108 Scalar_FLOAT64_IEEE 0 Arizona_all_IO_CM_double -1.7E+308 1.7E+308 /end CHARACTERISTIC
/begin CHARACTERISTIC Arizona_all_IO_cal_impl.DILimitGantryx2secundairGantr_g "" VALUE 0x0021E168 Scalar_FLOAT64_IEEE 0 Arizona_all_IO_CM_double -1.7E+308 1.7E+308 /end CHARACTERISTIC
/begin CHARACTERISTIC Arizona_all_IO_cal_impl.DILimitGantryx2secundairGantr_h "" VALUE 0x0021E150 Scalar_FLOAT64_IEEE 0 Arizona_all_IO_CM_double -1.7E+308 1.7E+308 /end CHARACTERISTIC
/begin CHARACTERISTIC Arizona_all_IO_cal_impl.DILimitGantryx2secundairGantr_i "" VALUE 0x0021E138 Scalar_FLOAT64_IEEE 0 Arizona_all_IO_CM_double -1.7E+308 1.7E+308 /end CHARACTERISTIC
/begin CHARACTERISTIC Arizona_all_IO_cal_impl.DILimitGantryx2secundairGantr_k "" VALUE 0x0021E0F0 Scalar_FLOAT64_IEEE 0 Arizona_all_IO_CM_double -1.7E+308 1.7E+308 /end CHARACTERISTIC
/begin CHARACTERISTIC Arizona_all_IO_cal_impl.DILimitGantryx2secundairGantr_n "" VALUE 0x0021E120 Scalar_FLOAT64_IEEE 0 Arizona_all_IO_CM_double -1.7E+308 1.7E+308 /end CHARACTERISTIC
/begin CHARACTERISTIC Arizona_all_IO_cal_impl.DIblacksoftwarebutton_P1 "" VALUE 0x0021E180 Scalar_FLOAT64_IEEE 0 Arizona_all_IO_CM_double -1.7E+308 1.7E+308 /end CHARACTERISTIC
/begin CHARACTERISTIC Arizona_all_IO_cal_impl.DIblacksoftwarebutton_P2 "" VALUE 0x0021E198 Scalar_FLOAT64_IEEE 0 Arizona_all_IO_CM_double -1.7E+308 1.7E+308 /end CHARACTERISTIC
/begin CHARACTERISTIC Arizona_all_IO_cal_impl.DIblacksoftwarebutton_P3 "" VALUE 0x0021E1B0 Scalar_FLOAT64_IEEE 0 Arizona_all_IO_CM_double -1.7E+308 1.7E+308 /end CHARACTERISTIC
/begin CHARACTERISTIC Arizona_all_IO_cal_impl.DIblacksoftwarebutton_P4 "" VALUE 0x0021E1C8 Scalar_FLOAT64_IEEE 0 Arizona_all_IO_CM_double -1.7E+308 1.7E+308 /end CHARACTERISTIC
/begin CHARACTERISTIC Arizona_all_IO_cal_impl.DIblacksoftwarebutton_P5 "" VALUE 0x0021E1E0 Scalar_FLOAT64_IEEE 0 Arizona_all_IO_CM_double -1.7E+308 1.7E+308 /end CHARACTERISTIC
/begin CHARACTERISTIC Arizona_all_IO_cal_impl.DIblacksoftwarebutton_P6 "" VALUE 0x0021E1F8 Scalar_FLOAT64_IEEE 0 Arizona_all_IO_CM_double -1.7E+308 1.7E+308 /end CHARACTERISTIC
/begin CHARACTERISTIC Arizona_all_IO_cal_impl.DIcarriageampfaultstatus_P1 "" VALUE 0x0021E210 Scalar_FLOAT64_IEEE 0 Arizona_all_IO_CM_double -1.7E+308 1.7E+308 /end CHARACTERISTIC
/begin CHARACTERISTIC Arizona_all_IO_cal_impl.DIcarriageampfaultstatus_P2 "" VALUE 0x0021E228 Scalar_FLOAT64_IEEE 0 Arizona_all_IO_CM_double -1.7E+308 1.7E+308 /end CHARACTERISTIC
/begin CHARACTERISTIC Arizona_all_IO_cal_impl.DIcarriageampfaultstatus_P3 "" VALUE 0x0021E240 Scalar_FLOAT64_IEEE 0 Arizona_all_IO_CM_double -1.7E+308 1.7E+308 /end CHARACTERISTIC
/begin CHARACTERISTIC Arizona_all_IO_cal_impl.DIcarriageampfaultstatus_P4 "" VALUE 0x0021E258 Scalar_FLOAT64_IEEE 0 Arizona_all_IO_CM_double -1.7E+308 1.7E+308 /end CHARACTERISTIC
/begin CHARACTERISTIC Arizona_all_IO_cal_impl.DIcarriageampfaultstatus_P5 "" VALUE 0x0021E270 Scalar_FLOAT64_IEEE 0 Arizona_all_IO_CM_double -1.7E+308 1.7E+308 /end CHARACTERISTIC
/begin CHARACTERISTIC Arizona_all_IO_cal_impl.DIcarriageampfaultstatus_P6 "" VALUE 0x0021E288 Scalar_FLOAT64_IEEE 0 Arizona_all_IO_CM_double -1.7E+308 1.7E+308 /end CHARACTERISTIC
/begin CHARACTERISTIC Arizona_all_IO_cal_impl.DIgantryx1faultstatus_P1 "" VALUE 0x0021E2A0 Scalar_FLOAT64_IEEE 0 Arizona_all_IO_CM_double -1.7E+308 1.7E+308 /end CHARACTERISTIC
/begin CHARACTERISTIC Arizona_all_IO_cal_impl.DIgantryx1faultstatus_P2 "" VALUE 0x0021E2B8 Scalar_FLOAT64_IEEE 0 Arizona_all_IO_CM_double -1.7E+308 1.7E+308 /end CHARACTERISTIC
/begin CHARACTERISTIC Arizona_all_IO_cal_impl.DIgantryx1faultstatus_P3 "" VALUE 0x0021E2D0 Scalar_FLOAT64_IEEE 0 Arizona_all_IO_CM_double -1.7E+308 1.7E+308 /end CHARACTERISTIC
/begin CHARACTERISTIC Arizona_all_IO_cal_impl.DIgantryx1faultstatus_P4 "" VALUE 0x0021E2E8 Scalar_FLOAT64_IEEE 0 Arizona_all_IO_CM_double -1.7E+308 1.7E+308 /end CHARACTERISTIC
/begin CHARACTERISTIC Arizona_all_IO_cal_impl.DIgantryx1faultstatus_P5 "" VALUE 0x0021E300 Scalar_FLOAT64_IEEE 0 Arizona_all_IO_CM_double -1.7E+308 1.7E+308 /end CHARACTERISTIC
/begin CHARACTERISTIC Arizona_all_IO_cal_impl.DIgantryx1faultstatus_P6 "" VALUE 0x0021E318 Scalar_FLOAT64_IEEE 0 Arizona_all_IO_CM_double -1.7E+308 1.7E+308 /end CHARACTERISTIC
/begin CHARACTERISTIC Arizona_all_IO_cal_impl.DIgantryx2faultstatus_P1 "" VALUE 0x0021E330 Scalar_FLOAT64_IEEE 0 Arizona_all_IO_CM_double -1.7E+308 1.7E+308 /end CHARACTERISTIC
/begin CHARACTERISTIC Arizona_all_IO_cal_impl.DIgantryx2faultstatus_P2 "" VALUE 0x0021E348 Scalar_FLOAT64_IEEE 0 Arizona_all_IO_CM_double -1.7E+308 1.7E+308 /end CHARACTERISTIC
/begin CHARACTERISTIC Arizona_all_IO_cal_impl.DIgantryx2faultstatus_P3 "" VALUE 0x0021E360 Scalar_FLOAT64_IEEE 0 Arizona_all_IO_CM_double -1.7E+308 1.7E+308 /end CHARACTERISTIC
/begin CHARACTERISTIC Arizona_all_IO_cal_impl.DIgantryx2faultstatus_P4 "" VALUE 0x0021E378 Scalar_FLOAT64_IEEE 0 Arizona_all_IO_CM_double -1.7E+308 1.7E+308 /end CHARACTERISTIC
/begin CHARACTERISTIC Arizona_all_IO_cal_impl.DIgantryx2faultstatus_P5 "" VALUE 0x0021E390 Scalar_FLOAT64_IEEE 0 Arizona_all_IO_CM_double -1.7E+308 1.7E+308 /end CHARACTERISTIC
/begin CHARACTERISTIC Arizona_all_IO_cal_impl.DIgantryx2faultstatus_P6 "" VALUE 0x0021E3A8 Scalar_FLOAT64_IEEE 0 Arizona_all_IO_CM_double -1.7E+308 1.7E+308 /end CHARACTERISTIC
/begin CHARACTERISTIC Arizona_all_IO_cal_impl.DIredsoftwarebutton_P1 "" VALUE 0x0021E3C0 Scalar_FLOAT64_IEEE 0 Arizona_all_IO_CM_double -1.7E+308 1.7E+308 /end CHARACTERISTIC
/begin CHARACTERISTIC Arizona_all_IO_cal_impl.DIredsoftwarebutton_P2 "" VALUE 0x0021E3D8 Scalar_FLOAT64_IEEE 0 Arizona_all_IO_CM_double -1.7E+308 1.7E+308 /end CHARACTERISTIC
/begin CHARACTERISTIC Arizona_all_IO_cal_impl.DIredsoftwarebutton_P3 "" VALUE 0x0021E3F0 Scalar_FLOAT64_IEEE 0 Arizona_all_IO_CM_double -1.7E+308 1.7E+308 /end CHARACTERISTIC
/begin CHARACTERISTIC Arizona_all_IO_cal_impl.DIredsoftwarebutton_P4 "" VALUE 0x0021E408 Scalar_FLOAT64_IEEE 0 Arizona_all_IO_CM_double -1.7E+308 1.7E+308 /end CHARACTERISTIC
/begin CHARACTERISTIC Arizona_all_IO_cal_impl.DIredsoftwarebutton_P5 "" VALUE 0x0021E420 Scalar_FLOAT64_IEEE 0 Arizona_all_IO_CM_double -1.7E+308 1.7E+308 /end CHARACTERISTIC
/begin CHARACTERISTIC Arizona_all_IO_cal_impl.DIredsoftwarebutton_P6 "" VALUE 0x0021E438 Scalar_FLOAT64_IEEE 0 Arizona_all_IO_CM_double -1.7E+308 1.7E+308 /end CHARACTERISTIC
/begin CHARACTERISTIC Arizona_all_IO_cal_impl.DOInhibitCarriage_P1 "" VALUE 0x0021DB20 Scalar_FLOAT64_IEEE 0 Arizona_all_IO_CM_double -1.7E+308 1.7E+308 /end CHARACTERISTIC
/begin CHARACTERISTIC Arizona_all_IO_cal_impl.DOInhibitCarriage_P2 "" VALUE 0x0021DB38 Scalar_FLOAT64_IEEE 0 Arizona_all_IO_CM_double -1.7E+308 1.7E+308 /end CHARACTERISTIC
/begin CHARACTERISTIC Arizona_all_IO_cal_impl.DOInhibitCarriage_P3 "" VALUE 0x0021DB50 Scalar_FLOAT64_IEEE 0 Arizona_all_IO_CM_double -1.7E+308 1.7E+308 /end CHARACTERISTIC
/begin CHARACTERISTIC Arizona_all_IO_cal_impl.DOInhibitCarriage_P4 "" VALUE 0x0021DB68 Scalar_FLOAT64_IEEE 0 Arizona_all_IO_CM_double -1.7E+308 1.7E+308 /end CHARACTERISTIC
/begin CHARACTERISTIC Arizona_all_IO_cal_impl.DOInhibitCarriage_P5 "" VALUE 0x0021DB80 Scalar_FLOAT64_IEEE 0 Arizona_all_IO_CM_double -1.7E+308 1.7E+308 /end CHARACTERISTIC
/begin CHARACTERISTIC Arizona_all_IO_cal_impl.DOInhibitCarriage_P6 "" VALUE 0x0021DB98 Scalar_FLOAT64_IEEE 0 Arizona_all_IO_CM_double -1.7E+308 1.7E+308 /end CHARACTERISTIC
/begin CHARACTERISTIC Arizona_all_IO_cal_impl.DOInhibitCarriage_P7 "" VALUE 0x0021DBB0 Scalar_FLOAT64_IEEE 0 Arizona_all_IO_CM_double -1.7E+308 1.7E+308 /end CHARACTERISTIC
/begin CHARACTERISTIC Arizona_all_IO_cal_impl.DOInhibitCarriage_P8 "" VALUE 0x0021DBC8 Scalar_FLOAT64_IEEE 0 Arizona_all_IO_CM_double -1.7E+308 1.7E+308 /end CHARACTERISTIC
/begin CHARACTERISTIC Arizona_all_IO_cal_impl.DOInhibitGantryx1GantryxR_P1 "" VALUE 0x0021E458 Scalar_FLOAT64_IEEE 0 Arizona_all_IO_CM_double -1.7E+308 1.7E+308 /end CHARACTERISTIC
/begin CHARACTERISTIC Arizona_all_IO_cal_impl.DOInhibitGantryx1GantryxR_P2 "" VALUE 0x0021E470 Scalar_FLOAT64_IEEE 0 Arizona_all_IO_CM_double -1.7E+308 1.7E+308 /end CHARACTERISTIC
/begin CHARACTERISTIC Arizona_all_IO_cal_impl.DOInhibitGantryx1GantryxR_P3 "" VALUE 0x0021E488 Scalar_FLOAT64_IEEE 0 Arizona_all_IO_CM_double -1.7E+308 1.7E+308 /end CHARACTERISTIC
/begin CHARACTERISTIC Arizona_all_IO_cal_impl.DOInhibitGantryx1GantryxR_P4 "" VALUE 0x0021E4A0 Scalar_FLOAT64_IEEE 0 Arizona_all_IO_CM_double -1.7E+308 1.7E+308 /end CHARACTERISTIC
/begin CHARACTERISTIC Arizona_all_IO_cal_impl.DOInhibitGantryx1GantryxR_P5 "" VALUE 0x0021E4B8 Scalar_FLOAT64_IEEE 0 Arizona_all_IO_CM_double -1.7E+308 1.7E+308 /end CHARACTERISTIC
/begin CHARACTERISTIC Arizona_all_IO_cal_impl.DOInhibitGantryx1GantryxR_P6 "" VALUE 0x0021E4D0 Scalar_FLOAT64_IEEE 0 Arizona_all_IO_CM_double -1.7E+308 1.7E+308 /end CHARACTERISTIC
/begin CHARACTERISTIC Arizona_all_IO_cal_impl.DOInhibitGantryx1GantryxR_P7 "" VALUE 0x0021E4E8 Scalar_FLOAT64_IEEE 0 Arizona_all_IO_CM_double -1.7E+308 1.7E+308 /end CHARACTERISTIC
/begin CHARACTERISTIC Arizona_all_IO_cal_impl.DOInhibitGantryx1GantryxR_P8 "" VALUE 0x0021E500 Scalar_FLOAT64_IEEE 0 Arizona_all_IO_CM_double -1.7E+308 1.7E+308 /end CHARACTERISTIC
/begin CHARACTERISTIC Arizona_all_IO_cal_impl.DOInhibitGantryx2DOGantryxL_P1 "" VALUE 0x0021E520 Scalar_FLOAT64_IEEE 0 Arizona_all_IO_CM_double -1.7E+308 1.7E+308 /end CHARACTERISTIC
/begin CHARACTERISTIC Arizona_all_IO_cal_impl.DOInhibitGantryx2DOGantryxL_P2 "" VALUE 0x0021E538 Scalar_FLOAT64_IEEE 0 Arizona_all_IO_CM_double -1.7E+308 1.7E+308 /end CHARACTERISTIC
/begin CHARACTERISTIC Arizona_all_IO_cal_impl.DOInhibitGantryx2DOGantryxL_P3 "" VALUE 0x0021E550 Scalar_FLOAT64_IEEE 0 Arizona_all_IO_CM_double -1.7E+308 1.7E+308 /end CHARACTERISTIC
/begin CHARACTERISTIC Arizona_all_IO_cal_impl.DOInhibitGantryx2DOGantryxL_P4 "" VALUE 0x0021E568 Scalar_FLOAT64_IEEE 0 Arizona_all_IO_CM_double -1.7E+308 1.7E+308 /end CHARACTERISTIC
/begin CHARACTERISTIC Arizona_all_IO_cal_impl.DOInhibitGantryx2DOGantryxL_P5 "" VALUE 0x0021E580 Scalar_FLOAT64_IEEE 0 Arizona_all_IO_CM_double -1.7E+308 1.7E+308 /end CHARACTERISTIC
/begin CHARACTERISTIC Arizona_all_IO_cal_impl.DOInhibitGantryx2DOGantryxL_P6 "" VALUE 0x0021E598 Scalar_FLOAT64_IEEE 0 Arizona_all_IO_CM_double -1.7E+308 1.7E+308 /end CHARACTERISTIC
/begin CHARACTERISTIC Arizona_all_IO_cal_impl.DOInhibitGantryx2DOGantryxL_P7 "" VALUE 0x0021E5B0 Scalar_FLOAT64_IEEE 0 Arizona_all_IO_CM_double -1.7E+308 1.7E+308 /end CHARACTERISTIC
/begin CHARACTERISTIC Arizona_all_IO_cal_impl.DOInhibitGantryx2DOGantryxL_P8 "" VALUE 0x0021E5C8 Scalar_FLOAT64_IEEE 0 Arizona_all_IO_CM_double -1.7E+308 1.7E+308 /end CHARACTERISTIC
/begin CHARACTERISTIC Arizona_all_IO_cal_impl.Gain1_Gain "" VALUE 0x0021D6E0 Scalar_FLOAT64_IEEE 0 Arizona_all_IO_CM_double -1.7E+308 1.7E+308 /end CHARACTERISTIC
/begin CHARACTERISTIC Arizona_all_IO_cal_impl.Gain2_Gain "" VALUE 0x0021D6E8 Scalar_FLOAT64_IEEE 0 Arizona_all_IO_CM_double -1.7E+308 1.7E+308 /end CHARACTERISTIC
/begin CHARACTERISTIC Arizona_all_IO_cal_impl.Gain3_Gain "" VALUE 0x0021D6F0 Scalar_FLOAT64_IEEE 0 Arizona_all_IO_CM_double -1.7E+308 1.7E+308 /end CHARACTERISTIC
/begin CHARACTERISTIC Arizona_all_IO_cal_impl.Gain4_Gain "" VALUE 0x0021D6F8 Scalar_FLOAT64_IEEE 0 Arizona_all_IO_CM_double -1.7E+308 1.7E+308 /end CHARACTERISTIC
/begin CHARACTERISTIC Arizona_all_IO_cal_impl.Gain9_Gain "" VALUE 0x0021E810 Scalar_FLOAT64_IEEE 0 Arizona_all_IO_CM_double -1.7E+308 1.7E+308 /end CHARACTERISTIC
/begin CHARACTERISTIC Arizona_all_IO_cal_impl.Gain_Gain "" VALUE 0x0021D6C8 Scalar_FLOAT64_IEEE 0 Arizona_all_IO_CM_double -1.7E+308 1.7E+308 /end CHARACTERISTIC
/begin CHARACTERISTIC Arizona_all_IO_cal_impl.GantryX1secundair_P1 "" VALUE 0x0021E828 Scalar_FLOAT64_IEEE 0 Arizona_all_IO_CM_double -1.7E+308 1.7E+308 /end CHARACTERISTIC
/begin CHARACTERISTIC Arizona_all_IO_cal_impl.GantryX1secundair_P10 "" VALUE 0x0021E900 Scalar_FLOAT64_IEEE 0 Arizona_all_IO_CM_double -1.7E+308 1.7E+308 /end CHARACTERISTIC
/begin CHARACTERISTIC Arizona_all_IO_cal_impl.GantryX1secundair_P11 "" VALUE 0x0021E918 Scalar_FLOAT64_IEEE 0 Arizona_all_IO_CM_double -1.7E+308 1.7E+308 /end CHARACTERISTIC
/begin CHARACTERISTIC Arizona_all_IO_cal_impl.GantryX1secundair_P12 "" VALUE 0x0021E930 Scalar_FLOAT64_IEEE 0 Arizona_all_IO_CM_double -1.7E+308 1.7E+308 /end CHARACTERISTIC
/begin CHARACTERISTIC Arizona_all_IO_cal_impl.GantryX1secundair_P13 "" VALUE 0x0021E948 Scalar_FLOAT64_IEEE 0 Arizona_all_IO_CM_double -1.7E+308 1.7E+308 /end CHARACTERISTIC
/begin CHARACTERISTIC Arizona_all_IO_cal_impl.GantryX1secundair_P14 "" VALUE 0x0021E960 Scalar_FLOAT64_IEEE 0 Arizona_all_IO_CM_double -1.7E+308 1.7E+308 /end CHARACTERISTIC
/begin CHARACTERISTIC Arizona_all_IO_cal_impl.GantryX1secundair_P15 "" VALUE 0x0021E978 Scalar_FLOAT64_IEEE 0 Arizona_all_IO_CM_double -1.7E+308 1.7E+308 /end CHARACTERISTIC
/begin CHARACTERISTIC Arizona_all_IO_cal_impl.GantryX1secundair_P16 "" VALUE 0x0021E990 Scalar_FLOAT64_IEEE 0 Arizona_all_IO_CM_double -1.7E+308 1.7E+308 /end CHARACTERISTIC
/begin CHARACTERISTIC Arizona_all_IO_cal_impl.GantryX1secundair_P17 "" VALUE 0x0021E9A8 Scalar_FLOAT64_IEEE 0 Arizona_all_IO_CM_double -1.7E+308 1.7E+308 /end CHARACTERISTIC
/begin CHARACTERISTIC Arizona_all_IO_cal_impl.GantryX1secundair_P18 "" VALUE 0x0021E9C0 Scalar_FLOAT64_IEEE 0 Arizona_all_IO_CM_double -1.7E+308 1.7E+308 /end CHARACTERISTIC
/begin CHARACTERISTIC Arizona_all_IO_cal_impl.GantryX1secundair_P19 "" VALUE 0x0021E9D8 Scalar_FLOAT64_IEEE 0 Arizona_all_IO_CM_double -1.7E+308 1.7E+308 /end CHARACTERISTIC
/begin CHARACTERISTIC Arizona_all_IO_cal_impl.GantryX1secundair_P2 "" VALUE 0x0021E840 Scalar_FLOAT64_IEEE 0 Arizona_all_IO_CM_double -1.7E+308 1.7E+308 /end CHARACTERISTIC
/begin CHARACTERISTIC Arizona_all_IO_cal_impl.GantryX1secundair_P20 "" VALUE 0x0021E9F0 Scalar_FLOAT64_IEEE 0 Arizona_all_IO_CM_double -1.7E+308 1.7E+308 /end CHARACTERISTIC
/begin CHARACTERISTIC Arizona_all_IO_cal_impl.GantryX1secundair_P21 "" VALUE 0x0021EA08 Scalar_FLOAT64_IEEE 0 Arizona_all_IO_CM_double -1.7E+308 1.7E+308 /end CHARACTERISTIC
/begin CHARACTERISTIC Arizona_all_IO_cal_impl.GantryX1secundair_P22 "" VALUE 0x0021EA20 Scalar_FLOAT64_IEEE 0 Arizona_all_IO_CM_double -1.7E+308 1.7E+308 /end CHARACTERISTIC
/begin CHARACTERISTIC Arizona_all_IO_cal_impl.GantryX1secundair_P23 "" VALUE 0x0021EA38 Scalar_FLOAT64_IEEE 0 Arizona_all_IO_CM_double -1.7E+308 1.7E+308 /end CHARACTERISTIC
/begin CHARACTERISTIC Arizona_all_IO_cal_impl.GantryX1secundair_P24 "" VALUE 0x0021EA50 Scalar_FLOAT64_IEEE 0 Arizona_all_IO_CM_double -1.7E+308 1.7E+308 /end CHARACTERISTIC
/begin CHARACTERISTIC Arizona_all_IO_cal_impl.GantryX1secundair_P3 "" VALUE 0x0021E858 Scalar_FLOAT64_IEEE 0 Arizona_all_IO_CM_double -1.7E+308 1.7E+308 /end CHARACTERISTIC
/begin CHARACTERISTIC Arizona_all_IO_cal_impl.GantryX1secundair_P4 "" VALUE 0x0021E870 Scalar_FLOAT64_IEEE 0 Arizona_all_IO_CM_double -1.7E+308 1.7E+308 /end CHARACTERISTIC
/begin CHARACTERISTIC Arizona_all_IO_cal_impl.GantryX1secundair_P5 "" VALUE 0x0021E888 Scalar_FLOAT64_IEEE 0 Arizona_all_IO_CM_double -1.7E+308 1.7E+308 /end CHARACTERISTIC
/begin CHARACTERISTIC Arizona_all_IO_cal_impl.GantryX1secundair_P6 "" VALUE 0x0021E8A0 Scalar_FLOAT64_IEEE 0 Arizona_all_IO_CM_double -1.7E+308 1.7E+308 /end CHARACTERISTIC
/begin CHARACTERISTIC Arizona_all_IO_cal_impl.GantryX1secundair_P7 "" VALUE 0x0021E8B8 Scalar_FLOAT64_IEEE 0 Arizona_all_IO_CM_double -1.7E+308 1.7E+308 /end CHARACTERISTIC
/begin CHARACTERISTIC Arizona_all_IO_cal_impl.GantryX1secundair_P8 "" VALUE 0x0021E8D0 Scalar_FLOAT64_IEEE 0 Arizona_all_IO_CM_double -1.7E+308 1.7E+308 /end CHARACTERISTIC
/begin CHARACTERISTIC Arizona_all_IO_cal_impl.GantryX1secundair_P9 "" VALUE 0x0021E8E8 Scalar_FLOAT64_IEEE 0 Arizona_all_IO_CM_double -1.7E+308 1.7E+308 /end CHARACTERISTIC
/begin CHARACTERISTIC Arizona_all_IO_cal_impl.Gantryx1GantryxR_P1 "" VALUE 0x0021E5E0 Scalar_FLOAT64_IEEE 0 Arizona_all_IO_CM_double -1.7E+308 1.7E+308 /end CHARACTERISTIC
/begin CHARACTERISTIC Arizona_all_IO_cal_impl.Gantryx1GantryxR_P10 "" VALUE 0x0021E6B8 Scalar_FLOAT64_IEEE 0 Arizona_all_IO_CM_double -1.7E+308 1.7E+308 /end CHARACTERISTIC
/begin CHARACTERISTIC Arizona_all_IO_cal_impl.Gantryx1GantryxR_P11 "" VALUE 0x0021E6D0 Scalar_FLOAT64_IEEE 0 Arizona_all_IO_CM_double -1.7E+308 1.7E+308 /end CHARACTERISTIC
/begin CHARACTERISTIC Arizona_all_IO_cal_impl.Gantryx1GantryxR_P12 "" VALUE 0x0021E6E8 Scalar_FLOAT64_IEEE 0 Arizona_all_IO_CM_double -1.7E+308 1.7E+308 /end CHARACTERISTIC
/begin CHARACTERISTIC Arizona_all_IO_cal_impl.Gantryx1GantryxR_P13 "" VALUE 0x0021E700 Scalar_FLOAT64_IEEE 0 Arizona_all_IO_CM_double -1.7E+308 1.7E+308 /end CHARACTERISTIC
/begin CHARACTERISTIC Arizona_all_IO_cal_impl.Gantryx1GantryxR_P14 "" VALUE 0x0021E718 Scalar_FLOAT64_IEEE 0 Arizona_all_IO_CM_double -1.7E+308 1.7E+308 /end CHARACTERISTIC
/begin CHARACTERISTIC Arizona_all_IO_cal_impl.Gantryx1GantryxR_P15 "" VALUE 0x0021E730 Scalar_FLOAT64_IEEE 0 Arizona_all_IO_CM_double -1.7E+308 1.7E+308 /end CHARACTERISTIC
/begin CHARACTERISTIC Arizona_all_IO_cal_impl.Gantryx1GantryxR_P16 "" VALUE 0x0021E748 Scalar_FLOAT64_IEEE 0 Arizona_all_IO_CM_double -1.7E+308 1.7E+308 /end CHARACTERISTIC
/begin CHARACTERISTIC Arizona_all_IO_cal_impl.Gantryx1GantryxR_P17 "" VALUE 0x0021E760 Scalar_FLOAT64_IEEE 0 Arizona_all_IO_CM_double -1.7E+308 1.7E+308 /end CHARACTERISTIC
/begin CHARACTERISTIC Arizona_all_IO_cal_impl.Gantryx1GantryxR_P18 "" VALUE 0x0021E778 Scalar_FLOAT64_IEEE 0 Arizona_all_IO_CM_double -1.7E+308 1.7E+308 /end CHARACTERISTIC
/begin CHARACTERISTIC Arizona_all_IO_cal_impl.Gantryx1GantryxR_P19 "" VALUE 0x0021E790 Scalar_FLOAT64_IEEE 0 Arizona_all_IO_CM_double -1.7E+308 1.7E+308 /end CHARACTERISTIC
/begin CHARACTERISTIC Arizona_all_IO_cal_impl.Gantryx1GantryxR_P2 "" VALUE 0x0021E5F8 Scalar_FLOAT64_IEEE 0 Arizona_all_IO_CM_double -1.7E+308 1.7E+308 /end CHARACTERISTIC
/begin CHARACTERISTIC Arizona_all_IO_cal_impl.Gantryx1GantryxR_P20 "" VALUE 0x0021E7A8 Scalar_FLOAT64_IEEE 0 Arizona_all_IO_CM_double -1.7E+308 1.7E+308 /end CHARACTERISTIC
/begin CHARACTERISTIC Arizona_all_IO_cal_impl.Gantryx1GantryxR_P21 "" VALUE 0x0021E7C0 Scalar_FLOAT64_IEEE 0 Arizona_all_IO_CM_double -1.7E+308 1.7E+308 /end CHARACTERISTIC
/begin CHARACTERISTIC Arizona_all_IO_cal_impl.Gantryx1GantryxR_P22 "" VALUE 0x0021E7D8 Scalar_FLOAT64_IEEE 0 Arizona_all_IO_CM_double -1.7E+308 1.7E+308 /end CHARACTERISTIC
/begin CHARACTERISTIC Arizona_all_IO_cal_impl.Gantryx1GantryxR_P23 "" VALUE 0x0021E7F0 Scalar_FLOAT64_IEEE 0 Arizona_all_IO_CM_double -1.7E+308 1.7E+308 /end CHARACTERISTIC
/begin CHARACTERISTIC Arizona_all_IO_cal_impl.Gantryx1GantryxR_P24 "" VALUE 0x0021E808 Scalar_FLOAT64_IEEE 0 Arizona_all_IO_CM_double -1.7E+308 1.7E+308 /end CHARACTERISTIC
/begin CHARACTERISTIC Arizona_all_IO_cal_impl.Gantryx1GantryxR_P3 "" VALUE 0x0021E610 Scalar_FLOAT64_IEEE 0 Arizona_all_IO_CM_double -1.7E+308 1.7E+308 /end CHARACTERISTIC
/begin CHARACTERISTIC Arizona_all_IO_cal_impl.Gantryx1GantryxR_P4 "" VALUE 0x0021E628 Scalar_FLOAT64_IEEE 0 Arizona_all_IO_CM_double -1.7E+308 1.7E+308 /end CHARACTERISTIC
/begin CHARACTERISTIC Arizona_all_IO_cal_impl.Gantryx1GantryxR_P5 "" VALUE 0x0021E640 Scalar_FLOAT64_IEEE 0 Arizona_all_IO_CM_double -1.7E+308 1.7E+308 /end CHARACTERISTIC
/begin CHARACTERISTIC Arizona_all_IO_cal_impl.Gantryx1GantryxR_P6 "" VALUE 0x0021E658 Scalar_FLOAT64_IEEE 0 Arizona_all_IO_CM_double -1.7E+308 1.7E+308 /end CHARACTERISTIC
/begin CHARACTERISTIC Arizona_all_IO_cal_impl.Gantryx1GantryxR_P7 "" VALUE 0x0021E670 Scalar_FLOAT64_IEEE 0 Arizona_all_IO_CM_double -1.7E+308 1.7E+308 /end CHARACTERISTIC
/begin CHARACTERISTIC Arizona_all_IO_cal_impl.Gantryx1GantryxR_P8 "" VALUE 0x0021E688 Scalar_FLOAT64_IEEE 0 Arizona_all_IO_CM_double -1.7E+308 1.7E+308 /end CHARACTERISTIC
/begin CHARACTERISTIC Arizona_all_IO_cal_impl.Gantryx1GantryxR_P9 "" VALUE 0x0021E6A0 Scalar_FLOAT64_IEEE 0 Arizona_all_IO_CM_double -1.7E+308 1.7E+308 /end CHARACTERISTIC
/begin CHARACTERISTIC Arizona_all_IO_cal_impl.Gantryx1enable0Inhibit1Enable_V "" VALUE 0x0021E440 Scalar_FLOAT64_IEEE 0 Arizona_all_IO_CM_double -1.7E+308 1.7E+308 /end CHARACTERISTIC
/begin CHARACTERISTIC Arizona_all_IO_cal_impl.Gantryx2GantryxL_P1 "" VALUE 0x0021EA68 Scalar_FLOAT64_IEEE 0 Arizona_all_IO_CM_double -1.7E+308 1.7E+308 /end CHARACTERISTIC
/begin CHARACTERISTIC Arizona_all_IO_cal_impl.Gantryx2GantryxL_P10 "" VALUE 0x0021EB40 Scalar_FLOAT64_IEEE 0 Arizona_all_IO_CM_double -1.7E+308 1.7E+308 /end CHARACTERISTIC
/begin CHARACTERISTIC Arizona_all_IO_cal_impl.Gantryx2GantryxL_P11 "" VALUE 0x0021EB58 Scalar_FLOAT64_IEEE 0 Arizona_all_IO_CM_double -1.7E+308 1.7E+308 /end CHARACTERISTIC
/begin CHARACTERISTIC Arizona_all_IO_cal_impl.Gantryx2GantryxL_P12 "" VALUE 0x0021EB70 Scalar_FLOAT64_IEEE 0 Arizona_all_IO_CM_double -1.7E+308 1.7E+308 /end CHARACTERISTIC
/begin CHARACTERISTIC Arizona_all_IO_cal_impl.Gantryx2GantryxL_P13 "" VALUE 0x0021EB88 Scalar_FLOAT64_IEEE 0 Arizona_all_IO_CM_double -1.7E+308 1.7E+308 /end CHARACTERISTIC
/begin CHARACTERISTIC Arizona_all_IO_cal_impl.Gantryx2GantryxL_P14 "" VALUE 0x0021EBA0 Scalar_FLOAT64_IEEE 0 Arizona_all_IO_CM_double -1.7E+308 1.7E+308 /end CHARACTERISTIC
/begin CHARACTERISTIC Arizona_all_IO_cal_impl.Gantryx2GantryxL_P15 "" VALUE 0x0021EBB8 Scalar_FLOAT64_IEEE 0 Arizona_all_IO_CM_double -1.7E+308 1.7E+308 /end CHARACTERISTIC
/begin CHARACTERISTIC Arizona_all_IO_cal_impl.Gantryx2GantryxL_P16 "" VALUE 0x0021EBD0 Scalar_FLOAT64_IEEE 0 Arizona_all_IO_CM_double -1.7E+308 1.7E+308 /end CHARACTERISTIC
/begin CHARACTERISTIC Arizona_all_IO_cal_impl.Gantryx2GantryxL_P17 "" VALUE 0x0021EBE8 Scalar_FLOAT64_IEEE 0 Arizona_all_IO_CM_double -1.7E+308 1.7E+308 /end CHARACTERISTIC
/begin CHARACTERISTIC Arizona_all_IO_cal_impl.Gantryx2GantryxL_P18 "" VALUE 0x0021EC00 Scalar_FLOAT64_IEEE 0 Arizona_all_IO_CM_double -1.7E+308 1.7E+308 /end CHARACTERISTIC
/begin CHARACTERISTIC Arizona_all_IO_cal_impl.Gantryx2GantryxL_P19 "" VALUE 0x0021EC18 Scalar_FLOAT64_IEEE 0 Arizona_all_IO_CM_double -1.7E+308 1.7E+308 /end CHARACTERISTIC
/begin CHARACTERISTIC Arizona_all_IO_cal_impl.Gantryx2GantryxL_P2 "" VALUE 0x0021EA80 Scalar_FLOAT64_IEEE 0 Arizona_all_IO_CM_double -1.7E+308 1.7E+308 /end CHARACTERISTIC
/begin CHARACTERISTIC Arizona_all_IO_cal_impl.Gantryx2GantryxL_P20 "" VALUE 0x0021EC30 Scalar_FLOAT64_IEEE 0 Arizona_all_IO_CM_double -1.7E+308 1.7E+308 /end CHARACTERISTIC
/begin CHARACTERISTIC Arizona_all_IO_cal_impl.Gantryx2GantryxL_P21 "" VALUE 0x0021EC48 Scalar_FLOAT64_IEEE 0 Arizona_all_IO_CM_double -1.7E+308 1.7E+308 /end CHARACTERISTIC
/begin CHARACTERISTIC Arizona_all_IO_cal_impl.Gantryx2GantryxL_P22 "" VALUE 0x0021EC60 Scalar_FLOAT64_IEEE 0 Arizona_all_IO_CM_double -1.7E+308 1.7E+308 /end CHARACTERISTIC
/begin CHARACTERISTIC Arizona_all_IO_cal_impl.Gantryx2GantryxL_P23 "" VALUE 0x0021EC78 Scalar_FLOAT64_IEEE 0 Arizona_all_IO_CM_double -1.7E+308 1.7E+308 /end CHARACTERISTIC
/begin CHARACTERISTIC Arizona_all_IO_cal_impl.Gantryx2GantryxL_P24 "" VALUE 0x0021EC90 Scalar_FLOAT64_IEEE 0 Arizona_all_IO_CM_double -1.7E+308 1.7E+308 /end CHARACTERISTIC
/begin CHARACTERISTIC Arizona_all_IO_cal_impl.Gantryx2GantryxL_P3 "" VALUE 0x0021EA98 Scalar_FLOAT64_IEEE 0 Arizona_all_IO_CM_double -1.7E+308 1.7E+308 /end CHARACTERISTIC
/begin CHARACTERISTIC Arizona_all_IO_cal_impl.Gantryx2GantryxL_P4 "" VALUE 0x0021EAB0 Scalar_FLOAT64_IEEE 0 Arizona_all_IO_CM_double -1.7E+308 1.7E+308 /end CHARACTERISTIC
/begin CHARACTERISTIC Arizona_all_IO_cal_impl.Gantryx2GantryxL_P5 "" VALUE 0x0021EAC8 Scalar_FLOAT64_IEEE 0 Arizona_all_IO_CM_double -1.7E+308 1.7E+308 /end CHARACTERISTIC
/begin CHARACTERISTIC Arizona_all_IO_cal_impl.Gantryx2GantryxL_P6 "" VALUE 0x0021EAE0 Scalar_FLOAT64_IEEE 0 Arizona_all_IO_CM_double -1.7E+308 1.7E+308 /end CHARACTERISTIC
/begin CHARACTERISTIC Arizona_all_IO_cal_impl.Gantryx2GantryxL_P7 "" VALUE 0x0021EAF8 Scalar_FLOAT64_IEEE 0 Arizona_all_IO_CM_double -1.7E+308 1.7E+308 /end CHARACTERISTIC
/begin CHARACTERISTIC Arizona_all_IO_cal_impl.Gantryx2GantryxL_P8 "" VALUE 0x0021EB10 Scalar_FLOAT64_IEEE 0 Arizona_all_IO_CM_double -1.7E+308 1.7E+308 /end CHARACTERISTIC
/begin CHARACTERISTIC Arizona_all_IO_cal_impl.Gantryx2GantryxL_P9 "" VALUE 0x0021EB28 Scalar_FLOAT64_IEEE 0 Arizona_all_IO_CM_double -1.7E+308 1.7E+308 /end CHARACTERISTIC
/begin CHARACTERISTIC Arizona_all_IO_cal_impl.Gantryx2enable0Inhibit1Enable_V "" VALUE 0x0021E508 Scalar_FLOAT64_IEEE 0 Arizona_all_IO_CM_double -1.7E+308 1.7E+308 /end CHARACTERISTIC
/begin CHARACTERISTIC Arizona_all_IO_cal_impl.GentryX2secundair_P1 "" VALUE 0x0021ECA8 Scalar_FLOAT64_IEEE 0 Arizona_all_IO_CM_double -1.7E+308 1.7E+308 /end CHARACTERISTIC
/begin CHARACTERISTIC Arizona_all_IO_cal_impl.GentryX2secundair_P10 "" VALUE 0x0021ED80 Scalar_FLOAT64_IEEE 0 Arizona_all_IO_CM_double -1.7E+308 1.7E+308 /end CHARACTERISTIC
/begin CHARACTERISTIC Arizona_all_IO_cal_impl.GentryX2secundair_P11 "" VALUE 0x0021ED98 Scalar_FLOAT64_IEEE 0 Arizona_all_IO_CM_double -1.7E+308 1.7E+308 /end CHARACTERISTIC
/begin CHARACTERISTIC Arizona_all_IO_cal_impl.GentryX2secundair_P12 "" VALUE 0x0021EDB0 Scalar_FLOAT64_IEEE 0 Arizona_all_IO_CM_double -1.7E+308 1.7E+308 /end CHARACTERISTIC
/begin CHARACTERISTIC Arizona_all_IO_cal_impl.GentryX2secundair_P13 "" VALUE 0x0021EDC8 Scalar_FLOAT64_IEEE 0 Arizona_all_IO_CM_double -1.7E+308 1.7E+308 /end CHARACTERISTIC
/begin CHARACTERISTIC Arizona_all_IO_cal_impl.GentryX2secundair_P14 "" VALUE 0x0021EDE0 Scalar_FLOAT64_IEEE 0 Arizona_all_IO_CM_double -1.7E+308 1.7E+308 /end CHARACTERISTIC
/begin CHARACTERISTIC Arizona_all_IO_cal_impl.GentryX2secundair_P15 "" VALUE 0x0021EDF8 Scalar_FLOAT64_IEEE 0 Arizona_all_IO_CM_double -1.7E+308 1.7E+308 /end CHARACTERISTIC
/begin CHARACTERISTIC Arizona_all_IO_cal_impl.GentryX2secundair_P16 "" VALUE 0x0021EE10 Scalar_FLOAT64_IEEE 0 Arizona_all_IO_CM_double -1.7E+308 1.7E+308 /end CHARACTERISTIC
/begin CHARACTERISTIC Arizona_all_IO_cal_impl.GentryX2secundair_P17 "" VALUE 0x0021EE28 Scalar_FLOAT64_IEEE 0 Arizona_all_IO_CM_double -1.7E+308 1.7E+308 /end CHARACTERISTIC
/begin CHARACTERISTIC Arizona_all_IO_cal_impl.GentryX2secundair_P18 "" VALUE 0x0021EE40 Scalar_FLOAT64_IEEE 0 Arizona_all_IO_CM_double -1.7E+308 1.7E+308 /end CHARACTERISTIC
/begin CHARACTERISTIC Arizona_all_IO_cal_impl.GentryX2secundair_P19 "" VALUE 0x0021EE58 Scalar_FLOAT64_IEEE 0 Arizona_all_IO_CM_double -1.7E+308 1.7E+308 /end CHARACTERISTIC
/begin CHARACTERISTIC Arizona_all_IO_cal_impl.GentryX2secundair_P2 "" VALUE 0x0021ECC0 Scalar_FLOAT64_IEEE 0 Arizona_all_IO_CM_double -1.7E+308 1.7E+308 /end CHARACTERISTIC
/begin CHARACTERISTIC Arizona_all_IO_cal_impl.GentryX2secundair_P20 "" VALUE 0x0021EE70 Scalar_FLOAT64_IEEE 0 Arizona_all_IO_CM_double -1.7E+308 1.7E+308 /end CHARACTERISTIC
/begin CHARACTERISTIC Arizona_all_IO_cal_impl.GentryX2secundair_P21 "" VALUE 0x0021EE88 Scalar_FLOAT64_IEEE 0 Arizona_all_IO_CM_double -1.7E+308 1.7E+308 /end CHARACTERISTIC
/begin CHARACTERISTIC Arizona_all_IO_cal_impl.GentryX2secundair_P22 "" VALUE 0x0021EEA0 Scalar_FLOAT64_IEEE 0 Arizona_all_IO_CM_double -1.7E+308 1.7E+308 /end CHARACTERISTIC
/begin CHARACTERISTIC Arizona_all_IO_cal_impl.GentryX2secundair_P23 "" VALUE 0x0021EEB8 Scalar_FLOAT64_IEEE 0 Arizona_all_IO_CM_double -1.7E+308 1.7E+308 /end CHARACTERISTIC
/begin CHARACTERISTIC Arizona_all_IO_cal_impl.GentryX2secundair_P24 "" VALUE 0x0021EED0 Scalar_FLOAT64_IEEE 0 Arizona_all_IO_CM_double -1.7E+308 1.7E+308 /end CHARACTERISTIC
/begin CHARACTERISTIC Arizona_all_IO_cal_impl.GentryX2secundair_P3 "" VALUE 0x0021ECD8 Scalar_FLOAT64_IEEE 0 Arizona_all_IO_CM_double -1.7E+308 1.7E+308 /end CHARACTERISTIC
/begin CHARACTERISTIC Arizona_all_IO_cal_impl.GentryX2secundair_P4 "" VALUE 0x0021ECF0 Scalar_FLOAT64_IEEE 0 Arizona_all_IO_CM_double -1.7E+308 1.7E+308 /end CHARACTERISTIC
/begin CHARACTERISTIC Arizona_all_IO_cal_impl.GentryX2secundair_P5 "" VALUE 0x0021ED08 Scalar_FLOAT64_IEEE 0 Arizona_all_IO_CM_double -1.7E+308 1.7E+308 /end CHARACTERISTIC
/begin CHARACTERISTIC Arizona_all_IO_cal_impl.GentryX2secundair_P6 "" VALUE 0x0021ED20 Scalar_FLOAT64_IEEE 0 Arizona_all_IO_CM_double -1.7E+308 1.7E+308 /end CHARACTERISTIC
/begin CHARACTERISTIC Arizona_all_IO_cal_impl.GentryX2secundair_P7 "" VALUE 0x0021ED38 Scalar_FLOAT64_IEEE 0 Arizona_all_IO_CM_double -1.7E+308 1.7E+308 /end CHARACTERISTIC
/begin CHARACTERISTIC Arizona_all_IO_cal_impl.GentryX2secundair_P8 "" VALUE 0x0021ED50 Scalar_FLOAT64_IEEE 0 Arizona_all_IO_CM_double -1.7E+308 1.7E+308 /end CHARACTERISTIC
/begin CHARACTERISTIC Arizona_all_IO_cal_impl.GentryX2secundair_P9 "" VALUE 0x0021ED68 Scalar_FLOAT64_IEEE 0 Arizona_all_IO_CM_double -1.7E+308 1.7E+308 /end CHARACTERISTIC
/begin CHARACTERISTIC Arizona_all_IO_cal_impl.Setup2_P1 "" VALUE 0x0021D080 Scalar_FLOAT64_IEEE 0 Arizona_all_IO_CM_double -1.7E+308 1.7E+308 /end CHARACTERISTIC
/begin CHARACTERISTIC Arizona_all_IO_cal_impl.Setup2_P10 "" VALUE 0x0021D1E0 Scalar_FLOAT64_IEEE 0 Arizona_all_IO_CM_double -1.7E+308 1.7E+308 /end CHARACTERISTIC
/begin CHARACTERISTIC Arizona_all_IO_cal_impl.Setup2_P11 "" VALUE 0x0021D1F8 Scalar_FLOAT64_IEEE 0 Arizona_all_IO_CM_double -1.7E+308 1.7E+308 /end CHARACTERISTIC
/begin CHARACTERISTIC Arizona_all_IO_cal_impl.Setup2_P12 "" VAL_BLK 0x0021D210 Scalar_FLOAT64_IEEE 0 Arizona_all_IO_CM_double -1.7E+308 1.7E+308 MATRIX_DIM 4 1 /end CHARACTERISTIC
/begin CHARACTERISTIC Arizona_all_IO_cal_impl.Setup2_P13 "" VALUE 0x0021D240 Scalar_FLOAT64_IEEE 0 Arizona_all_IO_CM_double -1.7E+308 1.7E+308 /end CHARACTERISTIC
/begin CHARACTERISTIC Arizona_all_IO_cal_impl.Setup2_P14 "" VALUE 0x0021D258 Scalar_FLOAT64_IEEE 0 Arizona_all_IO_CM_double -1.7E+308 1.7E+308 /end CHARACTERISTIC
/begin CHARACTERISTIC Arizona_all_IO_cal_impl.Setup2_P15 "" VALUE 0x0021D270 Scalar_FLOAT64_IEEE 0 Arizona_all_IO_CM_double -1.7E+308 1.7E+308 /end CHARACTERISTIC
/begin CHARACTERISTIC Arizona_all_IO_cal_impl.Setup2_P16 "" VAL_BLK 0x0021D288 Scalar_FLOAT64_IEEE 0 Arizona_all_IO_CM_double -1.7E+308 1.7E+308 MATRIX_DIM 2 1 /end CHARACTERISTIC
/begin CHARACTERISTIC Arizona_all_IO_cal_impl.Setup2_P17 "" VAL_BLK 0x0021D2A8 Scalar_FLOAT64_IEEE 0 Arizona_all_IO_CM_double -1.7E+308 1.7E+308 MATRIX_DIM 4 1 /end CHARACTERISTIC
/begin CHARACTERISTIC Arizona_all_IO_cal_impl.Setup2_P18 "" VAL_BLK 0x0021D2D8 Scalar_FLOAT64_IEEE 0 Arizona_all_IO_CM_double -1.7E+308 1.7E+308 MATRIX_DIM 4 1 /end CHARACTERISTIC
/begin CHARACTERISTIC Arizona_all_IO_cal_impl.Setup2_P19 "" VALUE 0x0021D308 Scalar_FLOAT64_IEEE 0 Arizona_all_IO_CM_double -1.7E+308 1.7E+308 /end CHARACTERISTIC
/begin CHARACTERISTIC Arizona_all_IO_cal_impl.Setup2_P2 "" VALUE 0x0021D098 Scalar_FLOAT64_IEEE 0 Arizona_all_IO_CM_double -1.7E+308 1.7E+308 /end CHARACTERISTIC
/begin CHARACTERISTIC Arizona_all_IO_cal_impl.Setup2_P20 "" VALUE 0x0021D320 Scalar_FLOAT64_IEEE 0 Arizona_all_IO_CM_double -1.7E+308 1.7E+308 /end CHARACTERISTIC
/begin CHARACTERISTIC Arizona_all_IO_cal_impl.Setup2_P21 "" VALUE 0x0021D338 Scalar_FLOAT64_IEEE 0 Arizona_all_IO_CM_double -1.7E+308 1.7E+308 /end CHARACTERISTIC
/begin CHARACTERISTIC Arizona_all_IO_cal_impl.Setup2_P22 "" VAL_BLK 0x0021D350 Scalar_FLOAT64_IEEE 0 Arizona_all_IO_CM_double -1.7E+308 1.7E+308 MATRIX_DIM 4 1 /end CHARACTERISTIC
/begin CHARACTERISTIC Arizona_all_IO_cal_impl.Setup2_P23 "" VALUE 0x0021D380 Scalar_FLOAT64_IEEE 0 Arizona_all_IO_CM_double -1.7E+308 1.7E+308 /end CHARACTERISTIC
/begin CHARACTERISTIC Arizona_all_IO_cal_impl.Setup2_P24 "" VALUE 0x0021D398 Scalar_FLOAT64_IEEE 0 Arizona_all_IO_CM_double -1.7E+308 1.7E+308 /end CHARACTERISTIC
/begin CHARACTERISTIC Arizona_all_IO_cal_impl.Setup2_P25 "" VALUE 0x0021D3B0 Scalar_FLOAT64_IEEE 0 Arizona_all_IO_CM_double -1.7E+308 1.7E+308 /end CHARACTERISTIC
/begin CHARACTERISTIC Arizona_all_IO_cal_impl.Setup2_P26 "" VALUE 0x0021D3C8 Scalar_FLOAT64_IEEE 0 Arizona_all_IO_CM_double -1.7E+308 1.7E+308 /end CHARACTERISTIC
/begin CHARACTERISTIC Arizona_all_IO_cal_impl.Setup2_P27 "" VALUE 0x0021D3E0 Scalar_FLOAT64_IEEE 0 Arizona_all_IO_CM_double -1.7E+308 1.7E+308 /end CHARACTERISTIC
/begin CHARACTERISTIC Arizona_all_IO_cal_impl.Setup2_P28 "" VALUE 0x0021D3F8 Scalar_FLOAT64_IEEE 0 Arizona_all_IO_CM_double -1.7E+308 1.7E+308 /end CHARACTERISTIC
/begin CHARACTERISTIC Arizona_all_IO_cal_impl.Setup2_P29 "" VALUE 0x0021D410 Scalar_FLOAT64_IEEE 0 Arizona_all_IO_CM_double -1.7E+308 1.7E+308 /end CHARACTERISTIC
/begin CHARACTERISTIC Arizona_all_IO_cal_impl.Setup2_P3 "" VALUE 0x0021D0B0 Scalar_FLOAT64_IEEE 0 Arizona_all_IO_CM_double -1.7E+308 1.7E+308 /end CHARACTERISTIC
/begin CHARACTERISTIC Arizona_all_IO_cal_impl.Setup2_P30 "" VALUE 0x0021D428 Scalar_FLOAT64_IEEE 0 Arizona_all_IO_CM_double -1.7E+308 1.7E+308 /end CHARACTERISTIC
/begin CHARACTERISTIC Arizona_all_IO_cal_impl.Setup2_P31 "" VALUE 0x0021D440 Scalar_FLOAT64_IEEE 0 Arizona_all_IO_CM_double -1.7E+308 1.7E+308 /end CHARACTERISTIC
/begin CHARACTERISTIC Arizona_all_IO_cal_impl.Setup2_P32 "" VALUE 0x0021D458 Scalar_FLOAT64_IEEE 0 Arizona_all_IO_CM_double -1.7E+308 1.7E+308 /end CHARACTERISTIC
/begin CHARACTERISTIC Arizona_all_IO_cal_impl.Setup2_P33 "" VAL_BLK 0x0021D470 Scalar_FLOAT64_IEEE 0 Arizona_all_IO_CM_double -1.7E+308 1.7E+308 MATRIX_DIM 3 1 /end CHARACTERISTIC
/begin CHARACTERISTIC Arizona_all_IO_cal_impl.Setup2_P34 "" VAL_BLK 0x0021D498 Scalar_FLOAT64_IEEE 0 Arizona_all_IO_CM_double -1.7E+308 1.7E+308 MATRIX_DIM 5 1 /end CHARACTERISTIC
/begin CHARACTERISTIC Arizona_all_IO_cal_impl.Setup2_P35 "" VALUE 0x0021D4D0 Scalar_FLOAT64_IEEE 0 Arizona_all_IO_CM_double -1.7E+308 1.7E+308 /end CHARACTERISTIC
/begin CHARACTERISTIC Arizona_all_IO_cal_impl.Setup2_P36 "" VALUE 0x0021D4E8 Scalar_FLOAT64_IEEE 0 Arizona_all_IO_CM_double -1.7E+308 1.7E+308 /end CHARACTERISTIC
/begin CHARACTERISTIC Arizona_all_IO_cal_impl.Setup2_P37 "" VALUE 0x0021D500 Scalar_FLOAT64_IEEE 0 Arizona_all_IO_CM_double -1.7E+308 1.7E+308 /end CHARACTERISTIC
/begin CHARACTERISTIC Arizona_all_IO_cal_impl.Setup2_P4 "" VALUE 0x0021D0C8 Scalar_FLOAT64_IEEE 0 Arizona_all_IO_CM_double -1.7E+308 1.7E+308 /end CHARACTERISTIC
/begin CHARACTERISTIC Arizona_all_IO_cal_impl.Setup2_P5 "" VALUE 0x0021D0E0 Scalar_FLOAT64_IEEE 0 Arizona_all_IO_CM_double -1.7E+308 1.7E+308 /end CHARACTERISTIC
/begin CHARACTERISTIC Arizona_all_IO_cal_impl.Setup2_P6 "" VAL_BLK 0x0021D0F8 Scalar_FLOAT64_IEEE 0 Arizona_all_IO_CM_double -1.7E+308 1.7E+308 MATRIX_DIM 2 1 /end CHARACTERISTIC
/begin CHARACTERISTIC Arizona_all_IO_cal_impl.Setup2_P7 "" VAL_BLK 0x0021D118 Scalar_FLOAT64_IEEE 0 Arizona_all_IO_CM_double -1.7E+308 1.7E+308 MATRIX_DIM 16 1 /end CHARACTERISTIC
/begin CHARACTERISTIC Arizona_all_IO_cal_impl.Setup2_P8 "" VAL_BLK 0x0021D1A8 Scalar_FLOAT64_IEEE 0 Arizona_all_IO_CM_double -1.7E+308 1.7E+308 MATRIX_DIM 2 1 /end CHARACTERISTIC
/begin CHARACTERISTIC Arizona_all_IO_cal_impl.Setup2_P9 "" VALUE 0x0021D1C8 Scalar_FLOAT64_IEEE 0 Arizona_all_IO_CM_double -1.7E+308 1.7E+308 /end CHARACTERISTIC
/begin CHARACTERISTIC Arizona_all_IO_cal_impl.WhiteNoise_Mean "" VALUE 0x0021D6D0 Scalar_FLOAT64_IEEE 0 Arizona_all_IO_CM_double -1.7E+308 1.7E+308 /end CHARACTERISTIC
/begin CHARACTERISTIC Arizona_all_IO_cal_impl.WhiteNoise_StdDev "" VALUE 0x0021D6D8 Scalar_FLOAT64_IEEE 0 Arizona_all_IO_CM_double -1.7E+308 1.7E+308 /end CHARACTERISTIC
/begin MEASUREMENT Arizona_all_IO_B.Cariagesecundair "" FLOAT64_IEEE Arizona_all_IO_CM_double 0 0 -1.7E+308 1.7E+308 ECU_ADDRESS 0x0022BA80 /end MEASUREMENT
/begin MEASUREMENT Arizona_all_IO_B.Carriageenable0Inhibit1Enable "" FLOAT64_IEEE Arizona_all_IO_CM_double 0 0 -1.7E+308 1.7E+308 ECU_ADDRESS 0x0022BA88 /end MEASUREMENT
/begin MEASUREMENT Arizona_all_IO_B.Carriageencoder "" FLOAT64_IEEE Arizona_all_IO_CM_double 0 0 -1.7E+308 1.7E+308 ECU_ADDRESS 0x0022BA90 /end MEASUREMENT
/begin MEASUREMENT Arizona_all_IO_B.DILimitCarriage "" FLOAT64_IEEE Arizona_all_IO_CM_double 0 0 -1.7E+308 1.7E+308 ECU_ADDRESS 0x0022BA98 /end MEASUREMENT
/begin MEASUREMENT Arizona_all_IO_B.DILimitCarriagesecundairwerktni "" FLOAT64_IEEE Arizona_all_IO_CM_double 0 0 -1.7E+308 1.7E+308 ECU_ADDRESS 0x0022BAA0 /end MEASUREMENT
/begin MEASUREMENT Arizona_all_IO_B.DILimitGantryx1GantryxR "" FLOAT64_IEEE Arizona_all_IO_CM_double 0 0 -1.7E+308 1.7E+308 ECU_ADDRESS 0x0022BAA8 /end MEASUREMENT
/begin MEASUREMENT Arizona_all_IO_B.DILimitGantryx1secundairGantryx "" FLOAT64_IEEE Arizona_all_IO_CM_double 0 0 -1.7E+308 1.7E+308 ECU_ADDRESS 0x0022BAB0 /end MEASUREMENT
/begin MEASUREMENT Arizona_all_IO_B.DILimitGantryx2GantryxL "" FLOAT64_IEEE Arizona_all_IO_CM_double 0 0 -1.7E+308 1.7E+308 ECU_ADDRESS 0x0022BAB8 /end MEASUREMENT
/begin MEASUREMENT Arizona_all_IO_B.DILimitGantryx2secundairGantryx "" FLOAT64_IEEE Arizona_all_IO_CM_double 0 0 -1.7E+308 1.7E+308 ECU_ADDRESS 0x0022BAC0 /end MEASUREMENT
/begin MEASUREMENT Arizona_all_IO_B.DIblacksoftwarebutton "" FLOAT64_IEEE Arizona_all_IO_CM_double 0 0 -1.7E+308 1.7E+308 ECU_ADDRESS 0x0022BAC8 /end MEASUREMENT
/begin MEASUREMENT Arizona_all_IO_B.DIcarriageampfaultstatus "" FLOAT64_IEEE Arizona_all_IO_CM_double 0 0 -1.7E+308 1.7E+308 ECU_ADDRESS 0x0022BAD0 /end MEASUREMENT
/begin MEASUREMENT Arizona_all_IO_B.DIgantryx1faultstatus "" FLOAT64_IEEE Arizona_all_IO_CM_double 0 0 -1.7E+308 1.7E+308 ECU_ADDRESS 0x0022BAD8 /end MEASUREMENT
/begin MEASUREMENT Arizona_all_IO_B.DIgantryx2faultstatus "" FLOAT64_IEEE Arizona_all_IO_CM_double 0 0 -1.7E+308 1.7E+308 ECU_ADDRESS 0x0022BAE0 /end MEASUREMENT
/begin MEASUREMENT Arizona_all_IO_B.DIredsoftwarebutton "" FLOAT64_IEEE Arizona_all_IO_CM_double 0 0 -1.7E+308 1.7E+308 ECU_ADDRESS 0x0022BAE8 /end MEASUREMENT
/begin MEASUREMENT Arizona_all_IO_B.Gain "" FLOAT64_IEEE Arizona_all_IO_CM_double 0 0 -1.7E+308 1.7E+308 ECU_ADDRESS 0x0022BA48 /end MEASUREMENT
/begin MEASUREMENT Arizona_all_IO_B.Gain1 "" FLOAT64_IEEE Arizona_all_IO_CM_double 0 0 -1.7E+308 1.7E+308 ECU_ADDRESS 0x0022BA60 /end MEASUREMENT
/begin MEASUREMENT Arizona_all_IO_B.Gain2 "" FLOAT64_IEEE Arizona_all_IO_CM_double 0 0 -1.7E+308 1.7E+308 ECU_ADDRESS 0x0022BA68 /end MEASUREMENT
/begin MEASUREMENT Arizona_all_IO_B.Gain3 "" FLOAT64_IEEE Arizona_all_IO_CM_double 0 0 -1.7E+308 1.7E+308 ECU_ADDRESS 0x0022BA70 /end MEASUREMENT
/begin MEASUREMENT Arizona_all_IO_B.GantryX1secundair "" FLOAT64_IEEE Arizona_all_IO_CM_double 0 0 -1.7E+308 1.7E+308 ECU_ADDRESS 0x0022BB10 /end MEASUREMENT
/begin MEASUREMENT Arizona_all_IO_B.Gantryx1GantryxR "" FLOAT64_IEEE Arizona_all_IO_CM_double 0 0 -1.7E+308 1.7E+308 ECU_ADDRESS 0x0022BB00 /end MEASUREMENT
/begin MEASUREMENT Arizona_all_IO_B.Gantryx1enable0Inhibit1Enable "" FLOAT64_IEEE Arizona_all_IO_CM_double 0 0 -1.7E+308 1.7E+308 ECU_ADDRESS 0x0022BAF0 /end MEASUREMENT
/begin MEASUREMENT Arizona_all_IO_B.Gantryx2GantryxL "" FLOAT64_IEEE Arizona_all_IO_CM_double 0 0 -1.7E+308 1.7E+308 ECU_ADDRESS 0x0022BB18 /end MEASUREMENT
/begin MEASUREMENT Arizona_all_IO_B.Gantryx2enable0Inhibit1Enable "" FLOAT64_IEEE Arizona_all_IO_CM_double 0 0 -1.7E+308 1.7E+308 ECU_ADDRESS 0x0022BAF8 /end MEASUREMENT
/begin MEASUREMENT Arizona_all_IO_B.GentryX2secundair "" FLOAT64_IEEE Arizona_all_IO_CM_double 0 0 -1.7E+308 1.7E+308 ECU_ADDRESS 0x0022BB20 /end MEASUREMENT
/begin MEASUREMENT Arizona_all_IO_B.LogicalOperator "" UBYTE Arizona_all_IO_CM_logical 0 0 0 1 ECU_ADDRESS 0x0022BB28 /end MEASUREMENT
/begin MEASUREMENT Arizona_all_IO_B.Output "" FLOAT64_IEEE Arizona_all_IO_CM_double 0 0 -1.7E+308 1.7E+308 ECU_ADDRESS 0x0022BA58 /end MEASUREMENT
/begin MEASUREMENT Arizona_all_IO_B.WhiteNoise "" FLOAT64_IEEE Arizona_all_IO_CM_double 0 0 -1.7E+308 1.7E+308 ECU_ADDRESS 0x0022BA50 /end MEASUREMENT
/begin MEASUREMENT Arizona_all_IO_B.analogvelin "" FLOAT64_IEEE Arizona_all_IO_CM_double 0 0 -1.7E+308 1.7E+308 ECU_ADDRESS 0x0022BA40 /end MEASUREMENT
/begin MEASUREMENT Arizona_all_IO_B.encodergantryx_R "" FLOAT64_IEEE Arizona_all_IO_CM_double 0 0 -1.7E+308 1.7E+308 ECU_ADDRESS 0x0022BB08 /end MEASUREMENT
/begin MEASUREMENT Arizona_all_IO_B.gantry_input_enabled_L "" FLOAT64_IEEE Arizona_all_IO_CM_double 0 0 -1.7E+308 1.7E+308 ECU_ADDRESS 0x0022BA78 /end MEASUREMENT
/begin MEASUREMENT Arizona_all_IO_DW.NextOutput "" FLOAT64_IEEE Arizona_all_IO_CM_double 0 0 -1.7E+308 1.7E+308 ECU_ADDRESS 0x0022B700 /end MEASUREMENT
/begin MEASUREMENT Arizona_all_IO_DW.RandSeed "" ULONG Arizona_all_IO_CM_uint32 0 0 0 4294967295 ECU_ADDRESS 0x0022BA30 /end MEASUREMENT
/begin COMPU_METHOD Arizona_all_IO_CM_double "" IDENTICAL "%15.10" "" /end COMPU_METHOD
/begin COMPU_METHOD Arizona_all_IO_CM_logical "" IDENTICAL "%1.0" "" /end COMPU_METHOD
/begin COMPU_METHOD Arizona_all_IO_CM_uint32 "" IDENTICAL "%10.0" "" /end COMPU_METHOD
/begin RECORD_LAYOUT Scalar_BOOLEAN FNC_VALUES 1 UBYTE COLUMN_DIR DIRECT /end RECORD_LAYOUT
/begin RECORD_LAYOUT Scalar_FLOAT64_IEEE FNC_VALUES 1 FLOAT64_IEEE COLUMN_DIR DIRECT /end RECORD_LAYOUT
/begin RECORD_LAYOUT Scalar_ULONG FNC_VALUES 1 ULONG COLUMN_DIR DIRECT /end RECORD_LAYOUT
/begin GROUP Arizona_all_IO "Arizona_all_IO" ROOT /begin SUB_GROUP Arizona_all_IO_Band_Limited_White_Noise_for_carriage /end SUB_GROUP
 /begin REF_CHARACTERISTIC Arizona_all_IO_cal_impl.Analoginput1_P1 Arizona_all_IO_cal_impl.Analoginput1_P10 Arizona_all_IO_cal_impl.Analoginput1_P11 Arizona_all_IO_cal_impl.Analoginput1_P12 Arizona_all_IO_cal_impl.Analoginput1_P2 Arizona_all_IO_cal_impl.Analoginput1_P3 Arizona_all_IO_cal_impl.Analoginput1_P4 Arizona_all_IO_cal_impl.Analoginput1_P5 Arizona_all_IO_cal_impl.Analoginput1_P6 Arizona_all_IO_cal_impl.Analoginput1_P7 Arizona_all_IO_cal_impl.Analoginput1_P8 Arizona_all_IO_cal_impl.Analoginput1_P9 Arizona_all_IO_cal_impl.Analogoutput2_P1 Arizona_all_IO_cal_impl.Analogoutput2_P10 Arizona_all_IO_cal_impl.Analogoutput2_P11 Arizona_all_IO_cal_impl.Analogoutput2_P12 Arizona_all_IO_cal_impl.Analogoutput2_P13 Arizona_all_IO_cal_impl.Analogoutput2_P14 Arizona_all_IO_cal_impl.Analogoutput2_P2 Arizona_all_IO_cal_impl.Analogoutput2_P3 Arizona_all_IO_cal_impl.Analogoutput2_P4 Arizona_all_IO_cal_impl.Analogoutput2_P5 Arizona_all_IO_cal_impl.Analogoutput2_P6 Arizona_all_IO_cal_impl.Analogoutput2_P7 Arizona_all_IO_cal_impl.Analogoutput2_P8 Arizona_all_IO_cal_impl.Analogoutput2_P9 Arizona_all_IO_cal_impl.Cariagesecundair_P1 Arizona_all_IO_cal_impl.Cariagesecundair_P10 Arizona_all_IO_cal_impl.Cariagesecundair_P11 Arizona_all_IO_cal_impl.Cariagesecundair_P12 Arizona_all_IO_cal_impl.Cariagesecundair_P13 Arizona_all_IO_cal_impl.Cariagesecundair_P14 Arizona_all_IO_cal_impl.Cariagesecundair_P15 Arizona_all_IO_cal_impl.Cariagesecundair_P16 Arizona_all_IO_cal_impl.Cariagesecundair_P17 Arizona_all_IO_cal_impl.Cariagesecundair_P18 Arizona_all_IO_cal_impl.Cariagesecundair_P19 Arizona_all_IO_cal_impl.Cariagesecundair_P2 Arizona_all_IO_cal_impl.Cariagesecundair_P20 Arizona_all_IO_cal_impl.Cariagesecundair_P21 Arizona_all_IO_cal_impl.Cariagesecundair_P22 Arizona_all_IO_cal_impl.Cariagesecundair_P23 Arizona_all_IO_cal_impl.Cariagesecundair_P24 Arizona_all_IO_cal_impl.Cariagesecundair_P3 Arizona_all_IO_cal_impl.Cariagesecundair_P4 Arizona_all_IO_cal_impl.Cariagesecundair_P5 Arizona_all_IO_cal_impl.Cariagesecundair_P6 Arizona_all_IO_cal_impl.Cariagesecundair_P7 Arizona_all_IO_cal_impl.Cariagesecundair_P8 Arizona_all_IO_cal_impl.Cariagesecundair_P9 Arizona_all_IO_cal_impl.Carriageenable0Inhibit1Enable_V Arizona_all_IO_cal_impl.Carriageencoder_P1 Arizona_all_IO_cal_impl.Carriageencoder_P10 Arizona_all_IO_cal_impl.Carriageencoder_P11 Arizona_all_IO_cal_impl.Carriageencoder_P12 Arizona_all_IO_cal_impl.Carriageencoder_P13 Arizona_all_IO_cal_impl.Carriageencoder_P14 Arizona_all_IO_cal_impl.Carriageencoder_P15 Arizona_all_IO_cal_impl.Carriageencoder_P16 Arizona_all_IO_cal_impl.Carriageencoder_P17 Arizona_all_IO_cal_impl.Carriageencoder_P18 Arizona_all_IO_cal_impl.Carriageencoder_P19 Arizona_all_IO_cal_impl.Carriageencoder_P2 Arizona_all_IO_cal_impl.Carriageencoder_P20 Arizona_all_IO_cal_impl.Carriageencoder_P21 Arizona_all_IO_cal_impl.Carriageencoder_P22 Arizona_all_IO_cal_impl.Carriageencoder_P23 Arizona_all_IO_cal_impl.Carriageencoder_P24 Arizona_all_IO_cal_impl.Carriageencoder_P3 Arizona_all_IO_cal_impl.Carriageencoder_P4 Arizona_all_IO_cal_impl.Carriageencoder_P5 Arizona_all_IO_cal_impl.Carriageencoder_P6 Arizona_all_IO_cal_impl.Carriageencoder_P7 Arizona_all_IO_cal_impl.Carriageencoder_P8 Arizona_all_IO_cal_impl.Carriageencoder_P9 Arizona_all_IO_cal_impl.DILimitCarriage_P1 Arizona_all_IO_cal_impl.DILimitCarriage_P2 Arizona_all_IO_cal_impl.DILimitCarriage_P3 Arizona_all_IO_cal_impl.DILimitCarriage_P4 Arizona_all_IO_cal_impl.DILimitCarriage_P5 Arizona_all_IO_cal_impl.DILimitCarriage_P6 Arizona_all_IO_cal_impl.DILimitCarriagesecundairwerk_cm Arizona_all_IO_cal_impl.DILimitCarriagesecundairwerkt_a Arizona_all_IO_cal_impl.DILimitCarriagesecundairwerkt_c Arizona_all_IO_cal_impl.DILimitCarriagesecundairwerkt_k Arizona_all_IO_cal_impl.DILimitCarriagesecundairwerkt_n Arizona_all_IO_cal_impl.DILimitCarriagesecundairwerkt_p Arizona_all_IO_cal_impl.DILimitGantryx1GantryxR_P1 Arizona_all_IO_cal_impl.DILimitGantryx1GantryxR_P2 Arizona_all_IO_cal_impl.DILimitGantryx1GantryxR_P3 Arizona_all_IO_cal_impl.DILimitGantryx1GantryxR_P4 Arizona_all_IO_cal_impl.DILimitGantryx1GantryxR_P5 Arizona_all_IO_cal_impl.DILimitGantryx1GantryxR_P6 Arizona_all_IO_cal_impl.DILimitGantryx1secundairGant_bw Arizona_all_IO_cal_impl.DILimitGantryx1secundairGantr_b Arizona_all_IO_cal_impl.DILimitGantryx1secundairGantr_f Arizona_all_IO_cal_impl.DILimitGantryx1secundairGantr_h Arizona_all_IO_cal_impl.DILimitGantryx1secundairGantr_m Arizona_all_IO_cal_impl.DILimitGantryx1secundairGantr_o Arizona_all_IO_cal_impl.DILimitGantryx2GantryxL_P1 Arizona_all_IO_cal_impl.DILimitGantryx2GantryxL_P2 Arizona_all_IO_cal_impl.DILimitGantryx2GantryxL_P3 Arizona_all_IO_cal_impl.DILimitGantryx2GantryxL_P4 Arizona_all_IO_cal_impl.DILimitGantryx2GantryxL_P5 Arizona_all_IO_cal_impl.DILimitGantryx2GantryxL_P6 Arizona_all_IO_cal_impl.DILimitGantryx2secundairGantr_e Arizona_all_IO_cal_impl.DILimitGantryx2secundairGantr_g Arizona_all_IO_cal_impl.DILimitGantryx2secundairGantr_h Arizona_all_IO_cal_impl.DILimitGantryx2secundairGantr_i Arizona_all_IO_cal_impl.DILimitGantryx2secundairGantr_k Arizona_all_IO_cal_impl.DILimitGantryx2secundairGantr_n Arizona_all_IO_cal_impl.DIblacksoftwarebutton_P1 Arizona_all_IO_cal_impl.DIblacksoftwarebutton_P2 Arizona_all_IO_cal_impl.DIblacksoftwarebutton_P3 Arizona_all_IO_cal_impl.DIblacksoftwarebutton_P4 Arizona_all_IO_cal_impl.DIblacksoftwarebutton_P5 Arizona_all_IO_cal_impl.DIblacksoftwarebutton_P6 Arizona_all_IO_cal_impl.DIcarriageampfaultstatus_P1 Arizona_all_IO_cal_impl.DIcarriageampfaultstatus_P2 Arizona_all_IO_cal_impl.DIcarriageampfaultstatus_P3 Arizona_all_IO_cal_impl.DIcarriageampfaultstatus_P4 Arizona_all_IO_cal_impl.DIcarriageampfaultstatus_P5 Arizona_all_IO_cal_impl.DIcarriageampfaultstatus_P6 Arizona_all_IO_cal_impl.DIgantryx1faultstatus_P1 Arizona_all_IO_cal_impl.DIgantryx1faultstatus_P2 Arizona_all_IO_cal_impl.DIgantryx1faultstatus_P3 Arizona_all_IO_cal_impl.DIgantryx1faultstatus_P4 Arizona_all_IO_cal_impl.DIgantryx1faultstatus_P5 Arizona_all_IO_cal_impl.DIgantryx1faultstatus_P6 Arizona_all_IO_cal_impl.DIgantryx2faultstatus_P1 Arizona_all_IO_cal_impl.DIgantryx2faultstatus_P2 Arizona_all_IO_cal_impl.DIgantryx2faultstatus_P3 Arizona_all_IO_cal_impl.DIgantryx2faultstatus_P4 Arizona_all_IO_cal_impl.DIgantryx2faultstatus_P5 Arizona_all_IO_cal_impl.DIgantryx2faultstatus_P6 Arizona_all_IO_cal_impl.DIredsoftwarebutton_P1 Arizona_all_IO_cal_impl.DIredsoftwarebutton_P2 Arizona_all_IO_cal_impl.DIredsoftwarebutton_P3 Arizona_all_IO_cal_impl.DIredsoftwarebutton_P4 Arizona_all_IO_cal_impl.DIredsoftwarebutton_P5 Arizona_all_IO_cal_impl.DIredsoftwarebutton_P6 Arizona_all_IO_cal_impl.DOInhibitCarriage_P1 Arizona_all_IO_cal_impl.DOInhibitCarriage_P2 Arizona_all_IO_cal_impl.DOInhibitCarriage_P3 Arizona_all_IO_cal_impl.DOInhibitCarriage_P4 Arizona_all_IO_cal_impl.DOInhibitCarriage_P5 Arizona_all_IO_cal_impl.DOInhibitCarriage_P6 Arizona_all_IO_cal_impl.DOInhibitCarriage_P7 Arizona_all_IO_cal_impl.DOInhibitCarriage_P8 Arizona_all_IO_cal_impl.DOInhibitGantryx1GantryxR_P1 Arizona_all_IO_cal_impl.DOInhibitGantryx1GantryxR_P2 Arizona_all_IO_cal_impl.DOInhibitGantryx1GantryxR_P3 Arizona_all_IO_cal_impl.DOInhibitGantryx1GantryxR_P4 Arizona_all_IO_cal_impl.DOInhibitGantryx1GantryxR_P5 Arizona_all_IO_cal_impl.DOInhibitGantryx1GantryxR_P6 Arizona_all_IO_cal_impl.DOInhibitGantryx1GantryxR_P7 Arizona_all_IO_cal_impl.DOInhibitGantryx1GantryxR_P8 Arizona_all_IO_cal_impl.DOInhibitGantryx2DOGantryxL_P1 Arizona_all_IO_cal_impl.DOInhibitGantryx2DOGantryxL_P2 Arizona_all_IO_cal_impl.DOInhibitGantryx2DOGantryxL_P3 Arizona_all_IO_cal_impl.DOInhibitGantryx2DOGantryxL_P4 Arizona_all_IO_cal_impl.DOInhibitGantryx2DOGantryxL_P5 Arizona_all_IO_cal_impl.DOInhibitGantryx2DOGantryxL_P6 Arizona_all_IO_cal_impl.DOInhibitGantryx2DOGantryxL_P7 Arizona_all_IO_cal_impl.DOInhibitGantryx2DOGantryxL_P8 Arizona_all_IO_cal_impl.Gain1_Gain Arizona_all_IO_cal_impl.Gain2_Gain Arizona_all_IO_cal_impl.Gain3_Gain Arizona_all_IO_cal_impl.Gain4_Gain Arizona_all_IO_cal_impl.Gain9_Gain Arizona_all_IO_cal_impl.Gain_Gain Arizona_all_IO_cal_impl.GantryX1secundair_P1 Arizona_all_IO_cal_impl.GantryX1secundair_P10 Arizona_all_IO_cal_impl.GantryX1secundair_P11 Arizona_all_IO_cal_impl.GantryX1secundair_P12 Arizona_all_IO_cal_impl.GantryX1secundair_P13 Arizona_all_IO_cal_impl.GantryX1secundair_P14 Arizona_all_IO_cal_impl.GantryX1secundair_P15 Arizona_all_IO_cal_impl.GantryX1secundair_P16 Arizona_all_IO_cal_impl.GantryX1secundair_P17 Arizona_all_IO_cal_impl.GantryX1secundair_P18 Arizona_all_IO_cal_impl.GantryX1secundair_P19 Arizona_all_IO_cal_impl.GantryX1secundair_P2 Arizona_all_IO_cal_impl.GantryX1secundair_P20 Arizona_all_IO_cal_impl.GantryX1secundair_P21 Arizona_all_IO_cal_impl.GantryX1secundair_P22 Arizona_all_IO_cal_impl.GantryX1secundair_P23 Arizona_all_IO_cal_impl.GantryX1secundair_P24 Arizona_all_IO_cal_impl.GantryX1secundair_P3 Arizona_all_IO_cal_impl.GantryX1secundair_P4 Arizona_all_IO_cal_impl.GantryX1secundair_P5 Arizona_all_IO_cal_impl.GantryX1secundair_P6 Arizona_all_IO_cal_impl.GantryX1secundair_P7 Arizona_all_IO_cal_impl.GantryX1secundair_P8 Arizona_all_IO_cal_impl.GantryX1secundair_P9 Arizona_all_IO_cal_impl.Gantryx1GantryxR_P1 Arizona_all_IO_cal_impl.Gantryx1GantryxR_P10 Arizona_all_IO_cal_impl.Gantryx1GantryxR_P11 Arizona_all_IO_cal_impl.Gantryx1GantryxR_P12 Arizona_all_IO_cal_impl.Gantryx1GantryxR_P13 Arizona_all_IO_cal_impl.Gantryx1GantryxR_P14 Arizona_all_IO_cal_impl.Gantryx1GantryxR_P15 Arizona_all_IO_cal_impl.Gantryx1GantryxR_P16 Arizona_all_IO_cal_impl.Gantryx1GantryxR_P17 Arizona_all_IO_cal_impl.Gantryx1GantryxR_P18 Arizona_all_IO_cal_impl.Gantryx1GantryxR_P19 Arizona_all_IO_cal_impl.Gantryx1GantryxR_P2 Arizona_all_IO_cal_impl.Gantryx1GantryxR_P20 Arizona_all_IO_cal_impl.Gantryx1GantryxR_P21 Arizona_all_IO_cal_impl.Gantryx1GantryxR_P22 Arizona_all_IO_cal_impl.Gantryx1GantryxR_P23 Arizona_all_IO_cal_impl.Gantryx1GantryxR_P24 Arizona_all_IO_cal_impl.Gantryx1GantryxR_P3 Arizona_all_IO_cal_impl.Gantryx1GantryxR_P4 Arizona_all_IO_cal_impl.Gantryx1GantryxR_P5 Arizona_all_IO_cal_impl.Gantryx1GantryxR_P6 Arizona_all_IO_cal_impl.Gantryx1GantryxR_P7 Arizona_all_IO_cal_impl.Gantryx1GantryxR_P8 Arizona_all_IO_cal_impl.Gantryx1GantryxR_P9 Arizona_all_IO_cal_impl.Gantryx1enable0Inhibit1Enable_V Arizona_all_IO_cal_impl.Gantryx2GantryxL_P1 Arizona_all_IO_cal_impl.Gantryx2GantryxL_P10 Arizona_all_IO_cal_impl.Gantryx2GantryxL_P11 Arizona_all_IO_cal_impl.Gantryx2GantryxL_P12 Arizona_all_IO_cal_impl.Gantryx2GantryxL_P13 Arizona_all_IO_cal_impl.Gantryx2GantryxL_P14 Arizona_all_IO_cal_impl.Gantryx2GantryxL_P15 Arizona_all_IO_cal_impl.Gantryx2GantryxL_P16 Arizona_all_IO_cal_impl.Gantryx2GantryxL_P17 Arizona_all_IO_cal_impl.Gantryx2GantryxL_P18 Arizona_all_IO_cal_impl.Gantryx2GantryxL_P19 Arizona_all_IO_cal_impl.Gantryx2GantryxL_P2 Arizona_all_IO_cal_impl.Gantryx2GantryxL_P20 Arizona_all_IO_cal_impl.Gantryx2GantryxL_P21 Arizona_all_IO_cal_impl.Gantryx2GantryxL_P22 Arizona_all_IO_cal_impl.Gantryx2GantryxL_P23 Arizona_all_IO_cal_impl.Gantryx2GantryxL_P24 Arizona_all_IO_cal_impl.Gantryx2GantryxL_P3 Arizona_all_IO_cal_impl.Gantryx2GantryxL_P4 Arizona_all_IO_cal_impl.Gantryx2GantryxL_P5 Arizona_all_IO_cal_impl.Gantryx2GantryxL_P6 Arizona_all_IO_cal_impl.Gantryx2GantryxL_P7 Arizona_all_IO_cal_impl.Gantryx2GantryxL_P8 Arizona_all_IO_cal_impl.Gantryx2GantryxL_P9 Arizona_all_IO_cal_impl.Gantryx2enable0Inhibit1Enable_V Arizona_all_IO_cal_impl.GentryX2secundair_P1 Arizona_all_IO_cal_impl.GentryX2secundair_P10 Arizona_all_IO_cal_impl.GentryX2secundair_P11 Arizona_all_IO_cal_impl.GentryX2secundair_P12 Arizona_all_IO_cal_impl.GentryX2secundair_P13 Arizona_all_IO_cal_impl.GentryX2secundair_P14 Arizona_all_IO_cal_impl.GentryX2secundair_P15 Arizona_all_IO_cal_impl.GentryX2secundair_P16 Arizona_all_IO_cal_impl.GentryX2secundair_P17 Arizona_all_IO_cal_impl.GentryX2secundair_P18 Arizona_all_IO_cal_impl.GentryX2secundair_P19 Arizona_all_IO_cal_impl.GentryX2secundair_P2 Arizona_all_IO_cal_impl.GentryX2secundair_P20 Arizona_all_IO_cal_impl.GentryX2secundair_P21 Arizona_all_IO_cal_impl.GentryX2secundair_P22 Arizona_all_IO_cal_impl.GentryX2secundair_P23 Arizona_all_IO_cal_impl.GentryX2secundair_P24 Arizona_all_IO_cal_impl.GentryX2secundair_P3 Arizona_all_IO_cal_impl.GentryX2secundair_P4 Arizona_all_IO_cal_impl.GentryX2secundair_P5 Arizona_all_IO_cal_impl.GentryX2secundair_P6 Arizona_all_IO_cal_impl.GentryX2secundair_P7 Arizona_all_IO_cal_impl.GentryX2secundair_P8 Arizona_all_IO_cal_impl.GentryX2secundair_P9 Arizona_all_IO_cal_impl.Setup2_P1 Arizona_all_IO_cal_impl.Setup2_P10 Arizona_all_IO_cal_impl.Setup2_P11 Arizona_all_IO_cal_impl.Setup2_P12 Arizona_all_IO_cal_impl.Setup2_P13 Arizona_all_IO_cal_impl.Setup2_P14 Arizona_all_IO_cal_impl.Setup2_P15 Arizona_all_IO_cal_impl.Setup2_P16 Arizona_all_IO_cal_impl.Setup2_P17 Arizona_all_IO_cal_impl.Setup2_P18 Arizona_all_IO_cal_impl.Setup2_P19 Arizona_all_IO_cal_impl.Setup2_P2 Arizona_all_IO_cal_impl.Setup2_P20 Arizona_all_IO_cal_impl.Setup2_P21 Arizona_all_IO_cal_impl.Setup2_P22 Arizona_all_IO_cal_impl.Setup2_P23 Arizona_all_IO_cal_impl.Setup2_P24 Arizona_all_IO_cal_impl.Setup2_P25 Arizona_all_IO_cal_impl.Setup2_P26 Arizona_all_IO_cal_impl.Setup2_P27 Arizona_all_IO_cal_impl.Setup2_P28 Arizona_all_IO_cal_impl.Setup2_P29 Arizona_all_IO_cal_impl.Setup2_P3 Arizona_all_IO_cal_impl.Setup2_P30 Arizona_all_IO_cal_impl.Setup2_P31 Arizona_all_IO_cal_impl.Setup2_P32 Arizona_all_IO_cal_impl.Setup2_P33 Arizona_all_IO_cal_impl.Setup2_P34 Arizona_all_IO_cal_impl.Setup2_P35 Arizona_all_IO_cal_impl.Setup2_P36 Arizona_all_IO_cal_impl.Setup2_P37 Arizona_all_IO_cal_impl.Setup2_P4 Arizona_all_IO_cal_impl.Setup2_P5 Arizona_all_IO_cal_impl.Setup2_P6 Arizona_all_IO_cal_impl.Setup2_P7 Arizona_all_IO_cal_impl.Setup2_P8 Arizona_all_IO_cal_impl.Setup2_P9 /end REF_CHARACTERISTIC
 /begin REF_MEASUREMENT Arizona_all_IO_B.Cariagesecundair Arizona_all_IO_B.Carriageenable0Inhibit1Enable Arizona_all_IO_B.Carriageencoder Arizona_all_IO_B.DILimitCarriage Arizona_all_IO_B.DILimitCarriagesecundairwerktni Arizona_all_IO_B.DILimitGantryx1GantryxR Arizona_all_IO_B.DILimitGantryx1secundairGantryx Arizona_all_IO_B.DILimitGantryx2GantryxL Arizona_all_IO_B.DILimitGantryx2secundairGantryx Arizona_all_IO_B.DIblacksoftwarebutton Arizona_all_IO_B.DIcarriageampfaultstatus Arizona_all_IO_B.DIgantryx1faultstatus Arizona_all_IO_B.DIgantryx2faultstatus Arizona_all_IO_B.DIredsoftwarebutton Arizona_all_IO_B.Gain1 Arizona_all_IO_B.Gain2 Arizona_all_IO_B.Gain3 Arizona_all_IO_B.GantryX1secundair Arizona_all_IO_B.Gantryx1GantryxR Arizona_all_IO_B.Gantryx1enable0Inhibit1Enable Arizona_all_IO_B.Gantryx2GantryxL Arizona_all_IO_B.Gantryx2enable0Inhibit1Enable Arizona_all_IO_B.GentryX2secundair Arizona_all_IO_B.LogicalOperator Arizona_all_IO_B.Output Arizona_all_IO_B.analogvelin Arizona_all_IO_B.encodergantryx_R Arizona_all_IO_B.gantry_input_enabled_L Arizona_all_IO_DW.Analoginput1_PWORK Arizona_all_IO_DW.Analogoutput2_PWORK Arizona_all_IO_DW.Cariagesecundair_PWORK Arizona_all_IO_DW.Carriageencoder_PWORK Arizona_all_IO_DW.DILimitCarriage_PWORK Arizona_all_IO_DW.DILimitCarriagesecundairwerktni Arizona_all_IO_DW.DILimitGantryx1GantryxR_PWORK Arizona_all_IO_DW.DILimitGantryx1secundairGantryx Arizona_all_IO_DW.DILimitGantryx2GantryxL_PWORK Arizona_all_IO_DW.DILimitGantryx2secundairGantryx Arizona_all_IO_DW.DIblacksoftwarebutton_PWORK Arizona_all_IO_DW.DIcarriageampfaultstatus_PWORK Arizona_all_IO_DW.DIgantryx1faultstatus_PWORK Arizona_all_IO_DW.DIgantryx2faultstatus_PWORK Arizona_all_IO_DW.DIredsoftwarebutton_PWORK Arizona_all_IO_DW.DOInhibitCarriage_PWORK Arizona_all_IO_DW.DOInhibitGantryx1GantryxR_PWORK Arizona_all_IO_DW.DOInhibitGantryx2DOGantryxL_PWO Arizona_all_IO_DW.GantryX1secundair_PWORK Arizona_all_IO_DW.Gantryx1GantryxR_PWORK Arizona_all_IO_DW.Gantryx2GantryxL_PWORK Arizona_all_IO_DW.GentryX2secundair_PWORK Arizona_all_IO_DW.Setup_PWORK /end REF_MEASUREMENT
/end GROUP
/begin GROUP Arizona_all_IO_Band_Limited_White_Noise_for_carriage "Arizona_all_IO/Band-Limited
White Noise for carriage"
 /begin REF_CHARACTERISTIC Arizona_all_IO_cal_impl.BandLimitedWhiteNoiseforcarri_p Arizona_all_IO_cal_impl.BandLimitedWhiteNoiseforcarriag Arizona_all_IO_cal_impl.WhiteNoise_Mean Arizona_all_IO_cal_impl.WhiteNoise_StdDev /end REF_CHARACTERISTIC
 /begin REF_MEASUREMENT Arizona_all_IO_B.Output Arizona_all_IO_B.WhiteNoise Arizona_all_IO_DW.NextOutput Arizona_all_IO_DW.RandSeed /end REF_MEASUREMENT
/end GROUP
/end MODULE
/end PROJECT
